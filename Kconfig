## tests/testcase.yaml
```yaml
common:
  tags:
    - snmp
    - unit
tests:
  snmp.agent.unit:
    platform_allow:
      - native_sim
      - native_sim/native/64
      - qemu_x86
    integration_platforms:
      - native_sim/native/64
    harness: ztest
```
