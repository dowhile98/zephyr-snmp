## CMakeLists.txt
```
cmake_minimum_required(VERSION 3.20.0)

list(APPEND EXTRA_ZEPHYR_MODULES "${CMAKE_CURRENT_SOURCE_DIR}/../..")

find_package(Zephyr REQUIRED HINTS $ENV{ZEPHYR_BASE})
project(snmp_agent_sample)

target_sources(app PRIVATE
    src/main.c
    src/app_led.c
    src/app_sensor.c
    src/app_button.c
    src/app_mib.c
)
```

## Kconfig
```
# Copyright (c) 2026 Zephyr SNMP Contributors
# SPDX-License-Identifier: Apache-2.0

mainmenu "SNMP Agent Validation Sample"

menu "SNMP Validation Sample Options"

config SNMP_SAMPLE_ENTERPRISE_ID
	int "Enterprise ID for Private MIB (1.3.6.1.4.1.<ID>)"
	default 54321
	help
	  Enterprise number under which the sample Private MIB is registered.
	  Default is 54321, resulting in OID tree 1.3.6.1.4.1.54321.1...

config SNMP_SAMPLE_SENSOR_OBJECT
	bool "Enable simulated sensor objects"
	default y
	help
	  Registers simulated sensors in Private MIB:
	  - sensorValue (INTEGER / simulated temperature)
	  - sensorHumidity (GAUGE32 / relative humidity)
	  - sensorDescription (OCTET STRING)
	  - sensorStatusOid (OBJECT IDENTIFIER)

config SNMP_SAMPLE_LED_OBJECT
	bool "Enable LED control object (ledState)"
	default y
	help
	  Registers ledState (read-write INTEGER) controlling the user LED (led0).

config SNMP_SAMPLE_BUTTON_TRAP
	bool "Enable User Button trap notification"
	default y
	help
	  Enables GPIO interrupt on User Button (sw0). Pressing the button sends
	  an SNMP Trap/Notification to the configured destination with buttonCounter.

config SNMP_SAMPLE_TRAP_DEST
	string "Trap destination IPv4 address"
	default "192.168.68.103"
	depends on SNMP_TRAP_ENABLED
	help
	  IP address of the SNMP Manager receiving traps and notifications on UDP port 162.

config SNMP_SAMPLE_SECOND_INSTANCE
	bool "Run a second SNMP agent instance (dual-instance demo)"
	depends on SNMP_MAX_INSTANCES >= 2
	default n
	help
	  Proves the multi-instance feature at application level: besides the LAN
	  agent (g_agent_lan) on CONFIG_SNMP_AGENT_PORT, main.c owns a second
	  independent struct snmp_agent (g_agent_wan) with its own sysName
	  ("NUCLEO-H743ZI-WAN"), its own MIB tree and its own counters, served on
	  the same interface but a different UDP port (SNMP_SAMPLE_WAN_PORT,
	  default 1610). Two instances cannot share :161 on one interface --
	  plain socket semantics make the second bind() fail with -EADDRINUSE --
	  so the demo uses a separate port instead.

	  Sizing the transport budgets (enforced by BUILD_ASSERT in
	  src/snmp_service.c):

	    CONFIG_ZVFS_POLL_MAX >= CONFIG_SNMP_MAX_INSTANCES * SNMP_SVC_FDS + 1

	  where SNMP_SVC_FDS is 2 with CONFIG_NET_IPV6 (IPv4 + IPv6 listener per
	  instance) and 1 otherwise, and the +1 is the socket-service thread's
	  eventfd. Keep additional headroom if other socket services (telnet
	  shell, custom) are registered in the same application. Each RUNNING
	  instance also costs ~31 KiB of struct RAM plus its socket-service
	  descriptor, so size CONFIG_SNMP_MAX_INSTANCES against the budget.

	  Enable with (qemu_x86 example, IPv6 => 2*2+1 = 5 poll entries):

	    west build -b qemu_x86 samples/snmp_agent -- \
	      -DCONFIG_SNMP_MAX_INSTANCES=2 -DCONFIG_ZVFS_POLL_MAX=5 \
	      -DCONFIG_SNMP_SAMPLE_SECOND_INSTANCE=y

	  Query the two instances with distinct sysName to verify isolation:
	    snmpget -v2c -c public udp:<IP>:1610 1.3.6.1.2.1.1.5.0

config SNMP_SAMPLE_WAN_PORT
	int "UDP port of the second (WAN) demo instance"
	default 1610
	depends on SNMP_SAMPLE_SECOND_INSTANCE
	range 1 65535
	help
	  Listen port of g_agent_wan. Must differ from CONFIG_SNMP_AGENT_PORT
	  because both demo instances share one interface.

endmenu

source "Kconfig.zephyr"
```

## sample.yaml
```
sample:
  name: SNMP Agent Sample
  description: Demonstrates Zephyr SNMP Agent (v1/v2c) with scalar and table nodes
tests:
  sample.net.snmp:
    platform_allow:
      - native_sim
      - qemu_x86
    tags:
      - net
      - snmp
```

## prj.conf
```kconfig
# Networking configuration
CONFIG_NETWORKING=y
CONFIG_NET_UDP=y
CONFIG_NET_SOCKETS=y
CONFIG_NET_SOCKETS_SERVICE=y
CONFIG_NET_IPV4=y
CONFIG_NET_CONFIG_SETTINGS=y
CONFIG_NET_CONFIG_NEED_IPV4=y
CONFIG_NET_CONFIG_MY_IPV4_ADDR="192.168.68.101"
CONFIG_NET_CONFIG_MY_IPV4_NETMASK="255.255.255.0"
CONFIG_NET_CONFIG_INIT_TIMEOUT=0

# DHCPv4 Client (Dynamic IP with Static fallback)
CONFIG_NET_DHCPV4=y
CONFIG_NET_IF_UNICAST_IPV4_ADDR_COUNT=2

# Network Management & Logging
CONFIG_NET_MGMT=y
CONFIG_NET_MGMT_EVENT=y
CONFIG_NET_MGMT_EVENT_STACK_SIZE=4096

# Hardware Peripherals (LED & User Button)
CONFIG_GPIO=y

# SNMP Subsystem Configuration
CONFIG_SNMP=y
CONFIG_SNMP_AGENT_PORT=161
CONFIG_SNMP_COMMUNITY_READ="public"
CONFIG_SNMP_COMMUNITY_WRITE="private"
# The sample exposes writable objects (ledState); the module default is read-only.
CONFIG_SNMP_SET_ENABLE=y
CONFIG_SNMP_VERSION_1=y
CONFIG_SNMP_VERSION_2C=y
CONFIG_SNMP_TRAP_ENABLED=y
CONFIG_SNMP_TRAP_PORT=162
CONFIG_SNMP_TRAP_FORMAT_V2C=y
CONFIG_SNMP_RATE_LIMIT=n

# SNMP Validation Sample Options
CONFIG_SNMP_SAMPLE_ENTERPRISE_ID=54321
CONFIG_SNMP_SAMPLE_SENSOR_OBJECT=y
CONFIG_SNMP_SAMPLE_LED_OBJECT=y
CONFIG_SNMP_SAMPLE_BUTTON_TRAP=y
CONFIG_SNMP_SAMPLE_TRAP_DEST="192.168.68.103"

# Dual-instance demo (default off, keeps this single-instance build intact).
# Enable together with its transport budgets (formula in Kconfig help):
#   west build -b <board> samples/snmp_agent -- \
#     -DCONFIG_SNMP_MAX_INSTANCES=2 -DCONFIG_ZVFS_POLL_MAX=5 \
#     -DCONFIG_SNMP_SAMPLE_SECOND_INSTANCE=y

# Stack size for network socket service thread (handles incoming SNMP packets)
CONFIG_NET_SOCKETS_SERVICE_STACK_SIZE=12288

CONFIG_MAIN_STACK_SIZE=4096
CONFIG_SYSTEM_WORKQUEUE_STACK_SIZE=4096
CONFIG_LOG=y
CONFIG_LOG_MODE_IMMEDIATE=y
CONFIG_SNMP_LOG_LEVEL_INF=y

# Interactive Shell via UART (type 'net iface', 'net ping' in terminal)
CONFIG_SHELL=y
CONFIG_SHELL_BACKENDS=y
CONFIG_SHELL_BACKEND_SERIAL=y
CONFIG_NET_SHELL=y
```

## src/main.c
```c
/*
 * Copyright (c) 2026 Zephyr SNMP Contributors
 * SPDX-License-Identifier: Apache-2.0
 */

#include <zephyr/kernel.h>
#include <zephyr/logging/log.h>
#include <zephyr/net/net_if.h>
#include <zephyr/net/net_mgmt.h>
#include <zephyr/net/net_event.h>
#include <zephyr/net/net_ip.h>
#include <errno.h>
#include <snmp/snmp.h>
#include <snmp/snmp_mib.h>
#include <snmp/snmp_trap.h>
#include "app_led.h"
#include "app_sensor.h"
#include "app_button.h"
#include "app_mib.h"

LOG_MODULE_REGISTER(main, LOG_LEVEL_INF);

#ifndef CONFIG_SNMP_SAMPLE_ENTERPRISE_ID
#define CONFIG_SNMP_SAMPLE_ENTERPRISE_ID 54321
#endif

#ifndef CONFIG_SNMP_SAMPLE_TRAP_DEST
#define CONFIG_SNMP_SAMPLE_TRAP_DEST "192.168.16.100"
#endif

#ifndef CONFIG_SNMP_AGENT_PORT
#define CONFIG_SNMP_AGENT_PORT 161
#endif

#ifndef CONFIG_SNMP_COMMUNITY_READ
#define CONFIG_SNMP_COMMUNITY_READ "public"
#endif

#ifndef CONFIG_SNMP_COMMUNITY_WRITE
#define CONFIG_SNMP_COMMUNITY_WRITE "private"
#endif

static struct net_mgmt_event_callback s_mgmt_cb;
static K_SEM_DEFINE(s_ip_ready_sem, 0, 1);
static struct net_if *s_snmp_iface;

/*
 * Caller-owned agent storage (decision #1 of the design contract): one instance is
 * always present; the optional second one demonstrates true multi-instance operation
 * on another UDP port with its own identity and its own MIB tree.
 */
static struct snmp_agent g_agent_lan;
#if defined(CONFIG_SNMP_SAMPLE_SECOND_INSTANCE)
static struct snmp_agent g_agent_wan;
#endif

static void print_banner(const char *ip_str)
{
	LOG_INF("================================================================");
	LOG_INF("       SNMP VALIDATION SAMPLE ON ZEPHYR RTOS (NUCLEO-H743ZI)    ");
	LOG_INF("================================================================");
	LOG_INF("Protocol Support:");
	LOG_INF("  - SNMPv1  : %s", IS_ENABLED(CONFIG_SNMP_VERSION_1) ? "ENABLED" : "DISABLED");
	LOG_INF("  - SNMPv2c : %s", IS_ENABLED(CONFIG_SNMP_VERSION_2C) ? "ENABLED" : "DISABLED");
	LOG_INF("  - SNMPv3  : %s", IS_ENABLED(CONFIG_SNMP_VERSION_3) ? "ENABLED" : "DISABLED");
	LOG_INF("Security & Network:");
	LOG_INF("  - Agent IP / Port : %s : %d", ip_str, CONFIG_SNMP_AGENT_PORT);
	LOG_INF("  - Read Community  : \"%s\"", CONFIG_SNMP_COMMUNITY_READ);
	LOG_INF("  - Write Community : \"%s\"", CONFIG_SNMP_COMMUNITY_WRITE);
#if defined(CONFIG_SNMP_SAMPLE_SECOND_INSTANCE)
	LOG_INF("  - Second instance: %s : %d (sysName \"%s\")", ip_str,
		CONFIG_SNMP_SAMPLE_WAN_PORT, "NUCLEO-H743ZI-WAN");
#endif
#if defined(CONFIG_SNMP_TRAP_ENABLED)
	LOG_INF("  - Trap Destination: %s : %d", CONFIG_SNMP_SAMPLE_TRAP_DEST,
		CONFIG_SNMP_TRAP_PORT);
#endif
	LOG_INF("Private MIB Structure (1.3.6.1.4.1.%d.1):", CONFIG_SNMP_SAMPLE_ENTERPRISE_ID);
	LOG_INF("  .1.1.1.0 sensorValue       (INTEGER, temp in C)   [R/W]");
	LOG_INF("  .1.1.2.0 ledState          (INTEGER, 0=OFF, 1=ON) [R/W]");
	LOG_INF("  .1.1.3.0 buttonCounter     (Counter32, press cnt) [RO]");
	LOG_INF("  .1.1.4.0 sensorHumidity    (Gauge32, %% relative)  [RO]");
	LOG_INF("  .1.1.5.0 sensorDescription (OCTET STRING)          [RO]");
	LOG_INF("  .1.1.6.0 sensorStatusOid   (OBJECT IDENTIFIER)    [RO]");
	LOG_INF("  .1.3.1 sensorTable       (Columns: idx, name, val)");
	LOG_INF("  .1.2.1 buttonPressed     (Notification/Trap)");
	LOG_INF("Validation Command Examples:");
	LOG_INF("  snmpget  -v2c -c %s %s 1.3.6.1.4.1.%d.1.1.1.0", CONFIG_SNMP_COMMUNITY_READ,
		ip_str, CONFIG_SNMP_SAMPLE_ENTERPRISE_ID);
	LOG_INF("  snmpset  -v2c -c %s %s 1.3.6.1.4.1.%d.1.1.2.0 i 1", CONFIG_SNMP_COMMUNITY_WRITE,
		ip_str, CONFIG_SNMP_SAMPLE_ENTERPRISE_ID);
	LOG_INF("  snmpwalk -v2c -c %s %s 1.3.6.1.4.1.%d.1", CONFIG_SNMP_COMMUNITY_READ, ip_str,
		CONFIG_SNMP_SAMPLE_ENTERPRISE_ID);
	LOG_INF("  snmpbulkwalk -v2c -c %s %s 1.3.6.1.4.1.%d.1.3", CONFIG_SNMP_COMMUNITY_READ,
		ip_str, CONFIG_SNMP_SAMPLE_ENTERPRISE_ID);
	LOG_INF("================================================================");
}

static void net_event_handler(struct net_mgmt_event_callback *cb, uint64_t mgmt_event,
			      struct net_if *iface)
{
	ARG_UNUSED(cb);
	if (mgmt_event == NET_EVENT_IPV4_ADDR_ADD && iface == s_snmp_iface) {
		k_sem_give(&s_ip_ready_sem);
	}
}

#if defined(CONFIG_SHELL)
#include <zephyr/shell/shell.h>
#include <stdlib.h>

static int cmd_app_button(const struct shell *sh, size_t argc, char **argv)
{
	ARG_UNUSED(argc);
	ARG_UNUSED(argv);
	shell_print(sh, "Simulating User Button press...");
	app_button_simulate_press();
	shell_print(sh, "Button count now: %u", app_button_get_counter());
	return 0;
}

static int cmd_app_led(const struct shell *sh, size_t argc, char **argv)
{
	if (argc < 2) {
		shell_print(sh, "User LED state: %s (%d)", app_led_get_state() ? "ON" : "OFF",
			    app_led_get_state());
		return 0;
	}
	int val = atoi(argv[1]);
	if (val != 0 && val != 1) {

		shell_error(sh, "Invalid value %d. Must be 0 (OFF) or 1 (ON).", val);
		return -EINVAL;
	}
	app_led_set_state(val);
	shell_print(sh, "User LED set to: %s (%d)", val ? "ON" : "OFF", val);
	return 0;
}

static int cmd_app_sensor(const struct shell *sh, size_t argc, char **argv)
{
	ARG_UNUSED(argc);
	ARG_UNUSED(argv);
	shell_print(sh, "Sensor Readings:");
	shell_print(sh, "  Temperature : %d C", app_sensor_get_temp());
	shell_print(sh, "  Humidity    : %u %%", app_sensor_get_humidity());
	shell_print(sh, "  Description : %s", app_sensor_get_description());
	shell_print(sh, "  Button Count: %u", app_button_get_counter());
	shell_print(sh, "  LED State   : %d", app_led_get_state());
	return 0;
}

SHELL_STATIC_SUBCMD_SET_CREATE(
	sub_app,
	SHELL_CMD(button, NULL, "Simulate User Button press and send SNMP Trap", cmd_app_button),
	SHELL_CMD_ARG(led, NULL, "Get or set User LED [0|1]", cmd_app_led, 1, 1),
	SHELL_CMD(sensor, NULL, "Display current sensor and device values", cmd_app_sensor),
	SHELL_SUBCMD_SET_END);

SHELL_CMD_REGISTER(app, &sub_app, "SNMP validation sample commands", NULL);
#endif

int main(void)
{
	LOG_INF("Booting SNMP Validation Sample...");

	s_snmp_iface = net_if_get_first_ethernet();
	if (!s_snmp_iface) {
		LOG_ERR("No Ethernet network interface found");
		return -ENODEV;
	}

	/* 1. Initialize hardware drivers that do not need the agent */
	app_led_init();
	app_sensor_init();

	/* 2. Register network management event listener */
	net_mgmt_init_event_callback(&s_mgmt_cb, net_event_handler,
				     NET_EVENT_IPV4_ADDR_ADD | NET_EVENT_IPV4_ADDR_DEL);
	net_mgmt_add_event_callback(&s_mgmt_cb);

	/* 3. Create the LAN agent instance on caller-owned static storage.
	 *    snmp_agent_init() only builds the domain state (MIB-II groups, identity,
	 *    communities); the UDP listener is opened later by snmp_agent_start().
	 */
	const struct snmp_agent_cfg cfg_lan = {
		.port = CONFIG_SNMP_AGENT_PORT,
		.iface = s_snmp_iface,
		.read_community = CONFIG_SNMP_COMMUNITY_READ,
		.write_community = CONFIG_SNMP_COMMUNITY_WRITE,
		.sys_descr = "Zephyr RTOS SNMP Validation Node (STM32H743ZI)",
		.sys_contact = "admin@example.com",
		.sys_name = "NUCLEO-H743ZI-SNMP",
		.sys_location = "Lab Bench 1",
		.settings_prefix = "snmp/lan",
	};
	int ret = snmp_agent_init(&g_agent_lan, &cfg_lan);
	if (ret < 0) {

		LOG_ERR("Failed to initialize LAN SNMP agent: %d", ret);
		return ret;
	}

	/* Button traps fire from a workqueue: hand it the agent to notify through. */
	app_button_init(&g_agent_lan);

	/* 4. Register Private MIB on the LAN agent */
	ret = app_mib_init(&g_agent_lan);
	if (ret < 0) {
		LOG_ERR("Failed to initialize Private MIB: %d", ret);
		return ret;
	}

#if defined(CONFIG_SNMP_TRAP_ENABLED)
	/* 5. Configure trap destination */
	snmp_trap_add_destination(&g_agent_lan, CONFIG_SNMP_SAMPLE_TRAP_DEST);
	LOG_INF("Configured SNMP Trap destination: %s", CONFIG_SNMP_SAMPLE_TRAP_DEST);
#endif

#if defined(CONFIG_SNMP_SAMPLE_SECOND_INSTANCE)
	/*
	 * 6. Second instance: same interface, different UDP port (two RUNNING agents
	 * cannot share :161 without an interface binding — plain socket semantics)
	 * and a distinct sysName. Its MIB tree, counters and community set are fully
	 * independent of g_agent_lan.
	 */
	const struct snmp_agent_cfg cfg_wan = {
		.port = CONFIG_SNMP_SAMPLE_WAN_PORT,
		.iface = s_snmp_iface,
		.read_community = CONFIG_SNMP_COMMUNITY_READ,
		.write_community = CONFIG_SNMP_COMMUNITY_WRITE,
		.sys_descr = "Zephyr RTOS SNMP Validation Node (WAN instance)",
		.sys_contact = "admin@example.com",
		.sys_name = "NUCLEO-H743ZI-WAN",
		.sys_location = "Lab Bench 1",
		.settings_prefix = "snmp/wan",
	};
	ret = snmp_agent_init(&g_agent_wan, &cfg_wan);
	if (ret < 0) {
		LOG_ERR("Failed to initialize WAN SNMP agent: %d", ret);
		return ret;
	}
	ret = app_mib_init(&g_agent_wan);
	if (ret < 0) {
		LOG_ERR("Failed to register Private MIB on WAN agent: %d", ret);
		return ret;
	}
#endif

	/* Check if interface already has IP assigned; if not, wait for DHCP */
	struct net_if *iface = s_snmp_iface;
	bool has_ip = false;
	char ip_buf[NET_IPV4_ADDR_LEN] = "192.0.2.1";

	if (iface && iface->config.ip.ipv4) {
		for (int i = 0; i < NET_IF_MAX_IPV4_ADDR; i++) {
			if (iface->config.ip.ipv4->unicast[i].ipv4.is_used &&
			    iface->config.ip.ipv4->unicast[i].ipv4.address.in_addr.s_addr != 0) {
				net_addr_ntop(
					AF_INET,
					&iface->config.ip.ipv4->unicast[i].ipv4.address.in_addr,
					ip_buf, sizeof(ip_buf));
				has_ip = true;
				break;
			}
		}
	}

	if (!has_ip) {
		LOG_INF("Waiting for DHCP lease...");
		k_sem_take(&s_ip_ready_sem, K_FOREVER);
		if (iface && iface->config.ip.ipv4) {
			for (int i = 0; i < NET_IF_MAX_IPV4_ADDR; i++) {
				if (iface->config.ip.ipv4->unicast[i].ipv4.is_used) {
					net_addr_ntop(AF_INET,
						      &iface->config.ip.ipv4->unicast[i]
							       .ipv4.address.in_addr,
						      ip_buf, sizeof(ip_buf));
					break;
				}
			}
		}
	}

	print_banner(ip_buf);

	/* 7. Open the UDP listeners only now that the interface has an address.
	 *    The coldStart trap stays ordered exactly like the old transport facade
	 *    documented it (former snmp_service.c): first an assigned IPv4 address,
	 *    then the listener, then the notification.
	 */
	ret = snmp_agent_start(&g_agent_lan);
	if (ret < 0) {
		LOG_ERR("Failed to start LAN SNMP agent: %d", ret);
		return ret;
	}
#if defined(CONFIG_SNMP_SAMPLE_SECOND_INSTANCE)
	ret = snmp_agent_start(&g_agent_wan);
	if (ret < 0) {
		LOG_ERR("Failed to start WAN SNMP agent: %d", ret);
		return ret;
	}
#endif

#if defined(CONFIG_SNMP_TRAP_ENABLED)
	snmp_trap_send_coldstart(&g_agent_lan);
	LOG_INF("ColdStart Trap dispatched to %s", CONFIG_SNMP_SAMPLE_TRAP_DEST);
#endif

	/* 8. Main loop: periodically update sensor values */
	while (1) {
		k_sleep(K_SECONDS(2));
		app_sensor_update_periodic();
	}

	return 0;
}
```

## src/app_button.c
```c
/*
 * Copyright (c) 2026 Zephyr SNMP Contributors
 * SPDX-License-Identifier: Apache-2.0
 */

#include "app_button.h"
#include "app_led.h"
#include <zephyr/kernel.h>
#include <zephyr/drivers/gpio.h>
#include <zephyr/logging/log.h>
#include <snmp/snmp.h>
#include <snmp/snmp_trap.h>

LOG_MODULE_REGISTER(app_button, LOG_LEVEL_INF);

#ifndef CONFIG_SNMP_SAMPLE_ENTERPRISE_ID
#define CONFIG_SNMP_SAMPLE_ENTERPRISE_ID 54321
#endif

static uint32_t s_button_counter;

/* Agent to notify through; set by app_button_init() from main.c's storage. */
static struct snmp_agent *s_trap_agent;

#if DT_NODE_EXISTS(DT_ALIAS(sw0))
static const struct gpio_dt_spec s_btn = GPIO_DT_SPEC_GET(DT_ALIAS(sw0), gpios);
static struct gpio_callback s_btn_cb_data;
static bool s_hardware_available;
static int64_t s_last_press_time;

static void button_work_handler(struct k_work *work);
static K_WORK_DEFINE(s_button_work, button_work_handler);

static void button_isr(const struct device *dev, struct gpio_callback *cb, uint32_t pins)
{
	ARG_UNUSED(dev);
	ARG_UNUSED(cb);
	ARG_UNUSED(pins);

	int64_t now = k_uptime_get();
	if (now - s_last_press_time > 200) {

		s_last_press_time = now;
		k_work_submit(&s_button_work);
	}
}

static void button_work_handler(struct k_work *work)
{
	ARG_UNUSED(work);

	s_button_counter++;
	LOG_INF("==================================================");
	LOG_INF(">>> User Button Pressed! Total Count: %u <<<", s_button_counter);
	LOG_INF("==================================================");

#if defined(CONFIG_SNMP_TRAP_ENABLED)
	app_button_trigger_notification();
#else
	LOG_INF("SNMP Traps disabled in Kconfig (CONFIG_SNMP_TRAP_ENABLED=n)");
#endif
}
#endif

int app_button_init(struct snmp_agent *agent)
{
#if !defined(CONFIG_SNMP_TRAP_ENABLED)
	ARG_UNUSED(agent);
#endif
	s_trap_agent = agent;

#if DT_NODE_EXISTS(DT_ALIAS(sw0))
	if (!gpio_is_ready_dt(&s_btn)) {
		LOG_WRN("User Button device %s not ready", s_btn.port->name);
		return -ENODEV;
	}

	int ret = gpio_pin_configure_dt(&s_btn, GPIO_INPUT);
	if (ret < 0) {

		LOG_ERR("Failed to configure button pin: %d", ret);
		return ret;
	}

	ret = gpio_pin_interrupt_configure_dt(&s_btn, GPIO_INT_EDGE_TO_ACTIVE);
	if (ret < 0) {
		LOG_ERR("Failed to configure button interrupt: %d", ret);
		return ret;
	}

	gpio_init_callback(&s_btn_cb_data, button_isr, BIT(s_btn.pin));
	ret = gpio_add_callback(s_btn.port, &s_btn_cb_data);
	if (ret < 0) {
		LOG_ERR("Failed to add button callback: %d", ret);
		return ret;
	}

	s_hardware_available = true;
	LOG_INF("User Button initialized on %s pin %d (Interrupt active edge)", s_btn.port->name,
		s_btn.pin);
	return 0;
#else
	LOG_WRN("No 'sw0' alias found in DeviceTree; manual triggering available");
	return 0;
#endif
}

uint32_t app_button_get_counter(void)
{
	return s_button_counter;
}

int app_button_trigger_notification(void)
{
#if defined(CONFIG_SNMP_TRAP_ENABLED)
	/* Notification OID: 1.3.6.1.4.1.<enterprise>.1.2.1 (buttonPressed) */
	struct snmp_oid trap_oid = {
		.len = 10, .ids = {1, 3, 6, 1, 4, 1, CONFIG_SNMP_SAMPLE_ENTERPRISE_ID, 1, 2, 1}};

	struct snmp_varbind varbinds[2];

	/* Varbind 1: buttonCounter (1.3.6.1.4.1.<enterprise>.1.1.3.0) */
	varbinds[0].oid.len = 10;
	varbinds[0].oid.ids[0] = 1;
	varbinds[0].oid.ids[1] = 3;
	varbinds[0].oid.ids[2] = 6;
	varbinds[0].oid.ids[3] = 1;
	varbinds[0].oid.ids[4] = 4;
	varbinds[0].oid.ids[5] = 1;
	varbinds[0].oid.ids[6] = CONFIG_SNMP_SAMPLE_ENTERPRISE_ID;
	varbinds[0].oid.ids[7] = 1;
	varbinds[0].oid.ids[8] = 1;
	varbinds[0].oid.ids[9] = 3;
	varbinds[0].oid.ids[10] = 0;
	varbinds[0].oid.len = 11;
	varbinds[0].type = SNMP_TAG_COUNTER32;
	varbinds[0].val.uint_val = s_button_counter;

	/* Varbind 2: ledState (1.3.6.1.4.1.<enterprise>.1.1.2.0) */
	varbinds[1].oid.len = 10;
	varbinds[1].oid.ids[0] = 1;
	varbinds[1].oid.ids[1] = 3;
	varbinds[1].oid.ids[2] = 6;
	varbinds[1].oid.ids[3] = 1;
	varbinds[1].oid.ids[4] = 4;
	varbinds[1].oid.ids[5] = 1;
	varbinds[1].oid.ids[6] = CONFIG_SNMP_SAMPLE_ENTERPRISE_ID;
	varbinds[1].oid.ids[7] = 1;
	varbinds[1].oid.ids[8] = 1;
	varbinds[1].oid.ids[9] = 2;
	varbinds[1].oid.ids[10] = 0;
	varbinds[1].oid.len = 11;
	varbinds[1].type = ASN1_TAG_INTEGER;
	varbinds[1].val.int_val = app_led_get_state();

	int ret = snmp_trap_send(s_trap_agent, &trap_oid, varbinds, 2, false);
	if (ret < 0) {

		LOG_WRN("Failed to send button SNMP notification: %d", ret);
		return ret;
	}

	LOG_INF("SNMP Notification dispatched successfully (buttonCounter=%u, ledState=%d)",
		s_button_counter, varbinds[1].val.int_val);
	return 0;
#else
	LOG_WRN("SNMP Trap engine is disabled");
	return -ENOTSUP;
#endif
}

int app_button_simulate_press(void)
{
	s_button_counter++;
	LOG_INF(">>> Simulated Button Press! Total Count: %u <<<", s_button_counter);
	return app_button_trigger_notification();
}
```

## src/app_button.h
```c
/*
 * Copyright (c) 2026 Zephyr SNMP Contributors
 * SPDX-License-Identifier: Apache-2.0
 */

#ifndef APP_BUTTON_H_
#define APP_BUTTON_H_

#include <stdint.h>

#ifdef __cplusplus
extern "C" {
#endif

/**
 * @brief Initialize user button hardware (sw0 alias) with GPIO interrupt and workqueue.
 * @return 0 on success, negative errno on failure.
 */
int app_button_init(void);

/**
 * @brief Get total user button press count.
 */
uint32_t app_button_get_counter(void);

/**
 * @brief Explicitly trigger the buttonPressed SNMP Trap/Notification.
 *        Can be called by button ISR or from shell / test code.
 * @return 0 on success, negative errno on failure.
 */
int app_button_trigger_notification(void);

/**
 * @brief Simulate button press (increments counter and triggers notification).
 * @return 0 on success, negative errno on failure.
 */
int app_button_simulate_press(void);

#ifdef __cplusplus
}
#endif

#endif /* APP_BUTTON_H_ */
```

## src/app_mib.c
```c
/*
 * Copyright (c) 2026 Zephyr SNMP Contributors
 * SPDX-License-Identifier: Apache-2.0
 */

#include "app_mib.h"
#include "app_led.h"
#include "app_sensor.h"
#include "app_button.h"
#include <zephyr/kernel.h>
#include <zephyr/logging/log.h>
#include <snmp/snmp.h>
#include <snmp/snmp_mib.h>
#include <string.h>
#include <errno.h>

LOG_MODULE_REGISTER(app_mib, LOG_LEVEL_INF);

#ifndef CONFIG_SNMP_SAMPLE_ENTERPRISE_ID
#define CONFIG_SNMP_SAMPLE_ENTERPRISE_ID 54321
#endif

/* -------------------------------------------------------------------------- */
/* Scalar Node Callbacks                                                      */
/* -------------------------------------------------------------------------- */

/* 1. sensorValue (1.3.6.1.4.1.<enterprise>.1.1.1.0) - INTEGER */
static int cb_get_sensor_value(struct snmp_agent *agent, const struct snmp_mib_node *node,
			       struct snmp_varbind *vb)
{
	ARG_UNUSED(agent);
	ARG_UNUSED(node);
	vb->type = ASN1_TAG_INTEGER;
	vb->val.int_val = app_sensor_get_temp();
	return 0;
}

static int cb_set_sensor_value(struct snmp_agent *agent, struct snmp_mib_node *node,
			       const struct snmp_varbind *vb)
{
	ARG_UNUSED(agent);
	ARG_UNUSED(node);
	if (vb->type != ASN1_TAG_INTEGER) {
		return -EINVAL;
	}
	app_sensor_set_temp(vb->val.int_val);
	return 0;
}

/* 2. ledState (1.3.6.1.4.1.<enterprise>.1.1.2.0) - INTEGER (0=OFF, 1=ON) */
static int cb_get_led_state(struct snmp_agent *agent, const struct snmp_mib_node *node,
			    struct snmp_varbind *vb)
{
	ARG_UNUSED(agent);
	ARG_UNUSED(node);
	vb->type = ASN1_TAG_INTEGER;
	vb->val.int_val = app_led_get_state();
	return 0;
}

static int cb_set_led_state(struct snmp_agent *agent, struct snmp_mib_node *node,
			    const struct snmp_varbind *vb)
{
	ARG_UNUSED(agent);
	ARG_UNUSED(node);
	if (vb->type != ASN1_TAG_INTEGER) {
		LOG_WRN("SNMP SET ledState rejected: invalid ASN.1 type 0x%02X", vb->type);
		return -EINVAL;
	}
	int ret = app_led_set_state(vb->val.int_val);
	if (ret < 0) {

		LOG_WRN("SNMP SET ledState rejected invalid value: %d", vb->val.int_val);
		return -EINVAL; /* Maps to badValue in SNMP response */
	}
	return 0;
}

/* 3. buttonCounter (1.3.6.1.4.1.<enterprise>.1.1.3.0) - Counter32 */
static int cb_get_button_counter(struct snmp_agent *agent, const struct snmp_mib_node *node,
				 struct snmp_varbind *vb)
{
	ARG_UNUSED(agent);
	ARG_UNUSED(node);
	vb->type = SNMP_TAG_COUNTER32;
	vb->val.uint_val = app_button_get_counter();
	return 0;
}

/* 4. sensorHumidity (1.3.6.1.4.1.<enterprise>.1.1.4.0) - Gauge32 */
static int cb_get_sensor_humidity(struct snmp_agent *agent, const struct snmp_mib_node *node,
				  struct snmp_varbind *vb)
{
	ARG_UNUSED(agent);
	ARG_UNUSED(node);
	vb->type = SNMP_TAG_GAUGE32;
	vb->val.uint_val = app_sensor_get_humidity();
	return 0;
}

/* 5. sensorDescription (1.3.6.1.4.1.<enterprise>.1.1.5.0) - OCTET STRING */
static int cb_get_sensor_desc(struct snmp_agent *agent, const struct snmp_mib_node *node,
			      struct snmp_varbind *vb)
{
	ARG_UNUSED(agent);
	ARG_UNUSED(node);
	vb->type = ASN1_TAG_OCTET_STRING;
	const char *desc = app_sensor_get_description();
	size_t len = strlen(desc);
	if (len > sizeof(vb->val.octet_str.data)) {

		len = sizeof(vb->val.octet_str.data);
	}
	memcpy(vb->val.octet_str.data, desc, len);
	vb->val.octet_str.len = (uint16_t)len;
	return 0;
}

/* 6. sensorStatusOid (1.3.6.1.4.1.<enterprise>.1.1.6.0) - OBJECT IDENTIFIER */
static int cb_get_sensor_status_oid(struct snmp_agent *agent, const struct snmp_mib_node *node,
				    struct snmp_varbind *vb)
{
	ARG_UNUSED(agent);
	ARG_UNUSED(node);
	vb->type = ASN1_TAG_OID;
	/* Points to sensorValue: 1.3.6.1.4.1.<enterprise>.1.1.1.0 */
	vb->val.oid.len = 11;
	vb->val.oid.ids[0] = 1;
	vb->val.oid.ids[1] = 3;
	vb->val.oid.ids[2] = 6;
	vb->val.oid.ids[3] = 1;
	vb->val.oid.ids[4] = 4;
	vb->val.oid.ids[5] = 1;
	vb->val.oid.ids[6] = CONFIG_SNMP_SAMPLE_ENTERPRISE_ID;
	vb->val.oid.ids[7] = 1;
	vb->val.oid.ids[8] = 1;
	vb->val.oid.ids[9] = 1;
	vb->val.oid.ids[10] = 0;
	return 0;
}

/* -------------------------------------------------------------------------- */
/* Table Node Callbacks: sensorTable (1.3.6.1.4.1.<enterprise>.1.3.1)         */
/* -------------------------------------------------------------------------- */

static int cb_table_col1_get(struct snmp_agent *agent, const struct snmp_table_row *row,
			     uint8_t column, struct snmp_varbind *vb)
{
	ARG_UNUSED(agent);
	ARG_UNUSED(column);
	vb->type = ASN1_TAG_INTEGER;
	vb->val.int_val = (int32_t)row->index;
	return 0;
}

static int cb_table_col2_get(struct snmp_agent *agent, const struct snmp_table_row *row,
			     uint8_t column, struct snmp_varbind *vb)
{
	ARG_UNUSED(agent);
	ARG_UNUSED(column);
	const char *name = NULL;
	int ret = app_sensor_get_table_entry(row->index, &name, NULL);
	if (ret < 0 || !name) {

		return -ENOENT;
	}

	vb->type = ASN1_TAG_OCTET_STRING;
	size_t len = strlen(name);
	if (len > sizeof(vb->val.octet_str.data)) {

		len = sizeof(vb->val.octet_str.data);
	}
	memcpy(vb->val.octet_str.data, name, len);
	vb->val.octet_str.len = (uint16_t)len;
	return 0;
}

static int cb_table_col3_get(struct snmp_agent *agent, const struct snmp_table_row *row,
			     uint8_t column, struct snmp_varbind *vb)
{
	ARG_UNUSED(agent);
	ARG_UNUSED(column);
	int32_t val = 0;
	int ret = app_sensor_get_table_entry(row->index, NULL, &val);
	if (ret < 0) {

		return -ENOENT;
	}

	vb->type = ASN1_TAG_INTEGER;
	vb->val.int_val = val;
	return 0;
}

static const uint8_t s_sensor_cols[] = {1, 2, 3};
static const uint8_t s_sensor_types[] = {ASN1_TAG_INTEGER, ASN1_TAG_OCTET_STRING, ASN1_TAG_INTEGER};
static snmp_table_get_cb_t s_sensor_get_cbs[] = {cb_table_col1_get, cb_table_col2_get,
						 cb_table_col3_get};

static struct snmp_table_row s_sensor_rows[3] = {{.index = 1}, {.index = 2}, {.index = 3}};

static struct snmp_mib_table s_sensor_table = {
	.table_oid = {.len = 10,
		      .ids = {1, 3, 6, 1, 4, 1, CONFIG_SNMP_SAMPLE_ENTERPRISE_ID, 1, 3, 1}},
	.column_cnt = 3,
	.column_subids = s_sensor_cols,
	.column_types = s_sensor_types,
	.get_cbs = s_sensor_get_cbs,
	.set_cbs = NULL,
};

int app_mib_init(struct snmp_agent *agent)
{
	int ret;

	/* Configure Enterprise OID for sysObjectID and Traps */
	struct snmp_oid ent_oid = {.len = 7,
				   .ids = {1, 3, 6, 1, 4, 1, CONFIG_SNMP_SAMPLE_ENTERPRISE_ID}};
	snmp_set_device_enterprise_oid(agent, &ent_oid);

#if defined(CONFIG_SNMP_SAMPLE_SENSOR_OBJECT)
	/* 1. Register sensorValue (1.3.6.1.4.1.<enterprise>.1.1.1.0) */
	static const struct snmp_mib_node node_sensor_val = {
		.oid = {.len = 11,
			.ids = {1, 3, 6, 1, 4, 1, CONFIG_SNMP_SAMPLE_ENTERPRISE_ID, 1, 1, 1, 0}},
		.type = ASN1_TAG_INTEGER,
		.get_cb = cb_get_sensor_value,
		.set_cb = cb_set_sensor_value,
	};
	ret = snmp_mib_register(agent, &node_sensor_val);
	if (ret < 0) {
		LOG_ERR("Failed to register sensorValue node: %d", ret);
		return ret;
	}

	/* 4. Register sensorHumidity (1.3.6.1.4.1.<enterprise>.1.1.4.0) */
	static const struct snmp_mib_node node_humidity = {
		.oid = {.len = 11,
			.ids = {1, 3, 6, 1, 4, 1, CONFIG_SNMP_SAMPLE_ENTERPRISE_ID, 1, 1, 4, 0}},
		.type = SNMP_TAG_GAUGE32,
		.get_cb = cb_get_sensor_humidity,
		.set_cb = NULL,
	};
	ret = snmp_mib_register(agent, &node_humidity);
	if (ret < 0) {
		LOG_ERR("Failed to register sensorHumidity node: %d", ret);
		return ret;
	}

	/* 5. Register sensorDescription (1.3.6.1.4.1.<enterprise>.1.1.5.0) */
	static const struct snmp_mib_node node_desc = {
		.oid = {.len = 11,
			.ids = {1, 3, 6, 1, 4, 1, CONFIG_SNMP_SAMPLE_ENTERPRISE_ID, 1, 1, 5, 0}},
		.type = ASN1_TAG_OCTET_STRING,
		.get_cb = cb_get_sensor_desc,
		.set_cb = NULL,
	};
	ret = snmp_mib_register(agent, &node_desc);
	if (ret < 0) {
		LOG_ERR("Failed to register sensorDescription node: %d", ret);
		return ret;
	}

	/* 6. Register sensorStatusOid (1.3.6.1.4.1.<enterprise>.1.1.6.0) */
	static const struct snmp_mib_node node_status_oid = {
		.oid = {.len = 11,
			.ids = {1, 3, 6, 1, 4, 1, CONFIG_SNMP_SAMPLE_ENTERPRISE_ID, 1, 1, 6, 0}},
		.type = ASN1_TAG_OID,
		.get_cb = cb_get_sensor_status_oid,
		.set_cb = NULL,
	};
	ret = snmp_mib_register(agent, &node_status_oid);
	if (ret < 0) {
		LOG_ERR("Failed to register sensorStatusOid node: %d", ret);
		return ret;
	}
#endif

#if defined(CONFIG_SNMP_SAMPLE_LED_OBJECT)
	/* 2. Register ledState (1.3.6.1.4.1.<enterprise>.1.1.2.0) */
	static const struct snmp_mib_node node_led = {
		.oid = {.len = 11,
			.ids = {1, 3, 6, 1, 4, 1, CONFIG_SNMP_SAMPLE_ENTERPRISE_ID, 1, 1, 2, 0}},
		.type = ASN1_TAG_INTEGER,
		.get_cb = cb_get_led_state,
		.set_cb = cb_set_led_state,
	};
	ret = snmp_mib_register(agent, &node_led);
	if (ret < 0) {
		LOG_ERR("Failed to register ledState node: %d", ret);
		return ret;
	}
#endif

#if defined(CONFIG_SNMP_SAMPLE_BUTTON_TRAP)
	/* 3. Register buttonCounter (1.3.6.1.4.1.<enterprise>.1.1.3.0) */
	static const struct snmp_mib_node node_btn = {
		.oid = {.len = 11,
			.ids = {1, 3, 6, 1, 4, 1, CONFIG_SNMP_SAMPLE_ENTERPRISE_ID, 1, 1, 3, 0}},
		.type = SNMP_TAG_COUNTER32,
		.get_cb = cb_get_button_counter,
		.set_cb = NULL,
	};
	ret = snmp_mib_register(agent, &node_btn);
	if (ret < 0) {
		LOG_ERR("Failed to register buttonCounter node: %d", ret);
		return ret;
	}
#endif

	/* 7. Register sensorTable (1.3.6.1.4.1.<enterprise>.1.3.1) */
	ret = snmp_mib_register_table(agent, &s_sensor_table);
	if (ret == 0) {
		/*
		 * The row list belongs to the shared, application-owned table, so it
		 * is linked once — by the first agent that registers it — while every
		 * instance is still INITIALIZED and no MIB walk can run concurrently.
		 */
		if (s_sensor_table.rows == NULL) {
			snmp_mib_table_add_row(agent, &s_sensor_table, &s_sensor_rows[0]);
			snmp_mib_table_add_row(agent, &s_sensor_table, &s_sensor_rows[1]);
			snmp_mib_table_add_row(agent, &s_sensor_table, &s_sensor_rows[2]);
		}
	} else {
		LOG_WRN("Failed to register sensorTable: %d", ret);
	}

	LOG_INF("Private MIB registered under 1.3.6.1.4.1.%d.1 (nucleoH743)",
		CONFIG_SNMP_SAMPLE_ENTERPRISE_ID);
	return 0;
}
```

## src/app_mib.h
```c
/*
 * Copyright (c) 2026 Zephyr SNMP Contributors
 * SPDX-License-Identifier: Apache-2.0
 */

#ifndef APP_MIB_H_
#define APP_MIB_H_

#ifdef __cplusplus
extern "C" {
#endif

struct snmp_agent;

/**
 * @brief Initialize and register the Private MIB for the sample on one agent:
 *        1.3.6.1.4.1.<enterprise>.1 (nucleoH743)
 *        - device (1)
 *          - sensorValue (1.0)
 *          - ledState (2.0)
 *          - buttonCounter (3.0)
 *          - sensorHumidity (4.0)
 *          - sensorDescription (5.0)
 *          - sensorStatusOid (6.0)
 *        - sensorTable (3)
 *
 *        Safe to call for more than one agent: the node structs are copied into
 *        each agent's own tree and the shared sensorTable row list is linked only
 *        once (before any listener runs).
 * @param agent Agent instance whose MIB tree receives the nodes. Caller-owned.
 * @return 0 on success, negative errno on failure.
 */
int app_mib_init(struct snmp_agent *agent);

#ifdef __cplusplus
}
#endif

#endif /* APP_MIB_H_ */
```

## src/app_sensor.c
```c
/*
 * Copyright (c) 2026 Zephyr SNMP Contributors
 * SPDX-License-Identifier: Apache-2.0
 */

#include "app_sensor.h"
#include <zephyr/kernel.h>
#include <zephyr/logging/log.h>
#include <errno.h>

LOG_MODULE_REGISTER(app_sensor, LOG_LEVEL_INF);

static int32_t s_temperature = 25;
static uint32_t s_humidity = 55;
static const char *const s_description = "NUCLEO-H743ZI Sensor Node";

static const char *const s_table_names[] = {"CPU Temp", "Amb Humidity", "Core Voltage"};

static int32_t s_table_static_values[] = {25, 55, 3300};

int app_sensor_init(void)
{
	s_temperature = 25;
	s_humidity = 55;
	LOG_INF("Sensor module initialized (Initial Temp: %d C, Hum: %u%%)", s_temperature,
		s_humidity);
	return 0;
}

int32_t app_sensor_get_temp(void)
{
	return s_temperature;
}

void app_sensor_set_temp(int32_t temp)
{
	s_temperature = temp;
	LOG_INF("Simulated temperature updated to %d C", s_temperature);
}

uint32_t app_sensor_get_humidity(void)
{
	return s_humidity;
}

const char *app_sensor_get_description(void)
{
	return s_description;
}

int app_sensor_get_table_entry(uint32_t index, const char **name, int32_t *value)
{
	if (index < 1 || index > 3) {
		return -ENOENT;
	}

	if (name) {
		*name = s_table_names[index - 1];
	}
	if (value) {
		if (index == 1) {
			*value = s_temperature;
		} else if (index == 2) {
			*value = (int32_t)s_humidity;
		} else {
			*value = s_table_static_values[index - 1];
		}
	}
	return 0;
}

void app_sensor_update_periodic(void)
{
	/* Vary temperature between 22 and 36 C based on uptime */
	uint32_t uptime_sec = (uint32_t)(k_uptime_get() / 1000);
	s_temperature = 22 + (int32_t)(uptime_sec % 15);

	/* Vary humidity between 45% and 65% */
	s_humidity = 45 + (uptime_sec * 3 % 21);
}
```

## src/app_sensor.h
```c
/*
 * Copyright (c) 2026 Zephyr SNMP Contributors
 * SPDX-License-Identifier: Apache-2.0
 */

#ifndef APP_SENSOR_H_
#define APP_SENSOR_H_

#include <stdint.h>
#include <stddef.h>

#ifdef __cplusplus
extern "C" {
#endif

/**
 * @brief Initialize sensor simulation module.
 */
int app_sensor_init(void);

/**
 * @brief Get simulated temperature (INTEGER, in °C).
 */
int32_t app_sensor_get_temp(void);

/**
 * @brief Set temperature (allows SNMP SET testing on sensor if enabled).
 */
void app_sensor_set_temp(int32_t temp);

/**
 * @brief Get simulated relative humidity (GAUGE32, 0-100%).
 */
uint32_t app_sensor_get_humidity(void);

/**
 * @brief Get sensor node description string (OCTET STRING).
 */
const char *app_sensor_get_description(void);

/**
 * @brief Get sensor table row information by 1-based index.
 * @param index 1 to 3
 * @param name Output pointer for sensor name
 * @param value Output pointer for sensor value
 * @return 0 on success, -ENOENT if index out of range.
 */
int app_sensor_get_table_entry(uint32_t index, const char **name, int32_t *value);

/**
 * @brief Periodic update function to simulate sensor readings variation.
 */
void app_sensor_update_periodic(void);

#ifdef __cplusplus
}
#endif

#endif /* APP_SENSOR_H_ */
```
