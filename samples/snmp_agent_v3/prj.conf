## CMakeLists.txt
```
cmake_minimum_required(VERSION 3.20.0)

list(APPEND EXTRA_ZEPHYR_MODULES "${CMAKE_CURRENT_SOURCE_DIR}/../..")

find_package(Zephyr REQUIRED HINTS $ENV{ZEPHYR_BASE})
project(snmp_agent_v3_sample)

target_sources(app PRIVATE
    src/main.c
    src/app_led.c
    src/app_sensor.c
    src/app_button.c
    src/app_mib.c
)
```

## Kconfig
```
# Copyright (c) 2026 Zephyr SNMP Contributors
# SPDX-License-Identifier: Apache-2.0

mainmenu "SNMP Agent Validation Sample"

menu "SNMP Validation Sample Options"

config SNMP_SAMPLE_ENTERPRISE_ID
	int "Enterprise ID for Private MIB (1.3.6.1.4.1.<ID>)"
	default 54321
	help
	  Enterprise number under which the sample Private MIB is registered.
	  Default is 54321, resulting in OID tree 1.3.6.1.4.1.54321.1...

config SNMP_SAMPLE_SENSOR_OBJECT
	bool "Enable simulated sensor objects"
	default y
	help
	  Registers simulated sensors in Private MIB:
	  - sensorValue (INTEGER / simulated temperature)
	  - sensorHumidity (GAUGE32 / relative humidity)
	  - sensorDescription (OCTET STRING)
	  - sensorStatusOid (OBJECT IDENTIFIER)

config SNMP_SAMPLE_LED_OBJECT
	bool "Enable LED control object (ledState)"
	default y
	help
	  Registers ledState (read-write INTEGER) controlling the user LED (led0).

config SNMP_SAMPLE_BUTTON_TRAP
	bool "Enable User Button trap notification"
	default y
	help
	  Enables GPIO interrupt on User Button (sw0). Pressing the button sends
	  an SNMP Trap/Notification to the configured destination with buttonCounter.

config SNMP_SAMPLE_TRAP_DEST
	string "Trap destination IPv4 address"
	default "192.168.68.103"
	depends on SNMP_TRAP_ENABLED
	help
	  IP address of the SNMP Manager receiving traps and notifications on UDP port 162.

config SNMP_SAMPLE_SECOND_INSTANCE
	bool "Run a second SNMP agent instance (dual-instance demo)"
	depends on SNMP_MAX_INSTANCES >= 2
	default n
	help
	  Proves the multi-instance feature at application level: besides the LAN
	  agent (g_agent_lan) on CONFIG_SNMP_AGENT_PORT, main.c owns a second
	  independent struct snmp_agent (g_agent_wan) with its own sysName
	  ("NUCLEO-H743ZI-WAN"), its own MIB tree and its own counters, served on
	  the same interface but a different UDP port (SNMP_SAMPLE_WAN_PORT,
	  default 1610). Two instances cannot share :161 on one interface --
	  plain socket semantics make the second bind() fail with -EADDRINUSE --
	  so the demo uses a separate port instead.

	  Sizing the transport budgets (enforced by BUILD_ASSERT in
	  src/snmp_service.c):

	    CONFIG_ZVFS_POLL_MAX >= CONFIG_SNMP_MAX_INSTANCES * SNMP_SVC_FDS + 1

	  where SNMP_SVC_FDS is 2 with CONFIG_NET_IPV6 (IPv4 + IPv6 listener per
	  instance) and 1 otherwise, and the +1 is the socket-service thread's
	  eventfd. Keep additional headroom if other socket services (telnet
	  shell, custom) are registered in the same application. Each RUNNING
	  instance also costs ~30 KiB of struct RAM (~39 KiB with v3) plus its socket-service
	  descriptor, so size CONFIG_SNMP_MAX_INSTANCES against the budget.

	  Enable with (qemu_x86 example, IPv6 => 2*2+1 = 5 poll entries):

	    west build -b qemu_x86 samples/snmp_agent_v3 -- \
	      -DCONFIG_SNMP_MAX_INSTANCES=2 -DCONFIG_ZVFS_POLL_MAX=5 \
	      -DCONFIG_SNMP_SAMPLE_SECOND_INSTANCE=y

	  Query the two instances with distinct sysName to verify isolation:
	    snmpget -v2c -c public udp:<IP>:1610 1.3.6.1.2.1.1.5.0

config SNMP_SAMPLE_WAN_PORT
	int "UDP port of the second (WAN) demo instance"
	default 1610
	depends on SNMP_SAMPLE_SECOND_INSTANCE
	range 1 65535
	help
	  Listen port of g_agent_wan. Must differ from CONFIG_SNMP_AGENT_PORT
	  because both demo instances share one interface.

config SNMP_SAMPLE_V3_ADMIN_USER
	string "authPriv admin user name"
	default "v3admin"
	help
	  Name of the authPriv demo user registered by main.c at runtime and
	  mapped to VACM group "admin" (fullView). The module ships no default
	  user: a v3 agent rejects every request until the application adds one.

config SNMP_SAMPLE_V3_ADMIN_AUTH_PASS
	string "authPriv admin authentication pass phrase"
	default "v3-admin-auth-passphrase-test-only"
	help
	  Test-only pass phrase for SNMP_SAMPLE_V3_ADMIN_USER. RFC 3414
	  section 11.2 requires at least 8 octets.

config SNMP_SAMPLE_V3_ADMIN_PRIV_PASS
	string "authPriv admin privacy pass phrase"
	default "v3-admin-priv-passphrase-test-only"
	help
	  Test-only privacy pass phrase for SNMP_SAMPLE_V3_ADMIN_USER. Used to
	  derive the AES-128-CFB key.

config SNMP_SAMPLE_V3_MONITOR_USER
	string "authNoPriv monitor user name"
	default "v3monitor"
	help
	  Name of the second USM user registered by main.c at runtime. The
	  user is created with HMAC-SHA-1 authentication and no privacy, and
	  it is the account already mapped to VACM group "readonly" by
	  snmp_vacm_init(), so it can read the system group but nothing else.
	  This exercises the authNoPriv path next to the authPriv default user.

config SNMP_SAMPLE_V3_MONITOR_AUTH_PASS
	string "authNoPriv monitor authentication pass phrase"
	default "v3-monitor-auth-passphrase-test-only"
	help
	  Test-only pass phrase for SNMP_SAMPLE_V3_MONITOR_USER. RFC 3414
	  section 11.2 requires at least 8 octets; anything shorter is
	  rejected by snmp_usm_add_user() with -EINVAL.

endmenu

source "Kconfig.zephyr"
```

## sample.yaml
```
sample:
  name: SNMPv3 Agent Sample
  description: >-
    SNMPv3 agent validation sample: USM authPriv and authNoPriv users, VACM
    restricted views, engine discovery/Report PDUs, AES-128-CFB privacy and v3
    notifications. Uses public test-only credentials.
tests:
  sample.net.snmp.v3:
    platform_allow:
      - native_sim
      - qemu_x86
    tags:
      - net
      - snmp
      - security
```

## prj.conf
```kconfig
# =============================================================================
# SNMPv3 validation sample configuration
#
# Every credential below is a **public test value** that ships in this repository.
# They exist so that a developer can reproduce an authenticated, encrypted SNMPv3
# exchange without generating keys first. Never copy them into a product image.
# =============================================================================

# Networking configuration
CONFIG_NETWORKING=y
CONFIG_NET_UDP=y
CONFIG_NET_SOCKETS=y
CONFIG_NET_SOCKETS_SERVICE=y
CONFIG_NET_IPV4=y
CONFIG_NET_CONFIG_SETTINGS=y
CONFIG_NET_CONFIG_NEED_IPV4=y
CONFIG_NET_CONFIG_MY_IPV4_ADDR="192.168.68.102"
CONFIG_NET_CONFIG_MY_IPV4_NETMASK="255.255.255.0"
CONFIG_NET_CONFIG_INIT_TIMEOUT=0

# DHCPv4 client (dynamic IP with the static address above as fallback)
CONFIG_NET_DHCPV4=y
CONFIG_NET_IF_UNICAST_IPV4_ADDR_COUNT=2

# Network management & logging
CONFIG_NET_MGMT=y
CONFIG_NET_MGMT_EVENT=y
CONFIG_NET_MGMT_EVENT_STACK_SIZE=4096

# Hardware peripherals (LED & user button)
CONFIG_GPIO=y

# SNMP subsystem configuration
CONFIG_SNMP=y
CONFIG_SNMP_AGENT_PORT=161
CONFIG_SNMP_COMMUNITY_READ="public"
CONFIG_SNMP_COMMUNITY_WRITE="private"
# The sample exposes writable objects (ledState); the module default is read-only.
CONFIG_SNMP_SET_ENABLE=y

# v3 is the point of this sample; v2c stays enabled so the same build can be used
# to compare v2c and v3 behaviour against one agent instance.
CONFIG_SNMP_VERSION_3=y
CONFIG_SNMP_VERSION_2C=y
CONFIG_SNMP_RATE_LIMIT=n

# --- Test-only USM identity -------------------------------------------------
# The module ships no default user (empty CONFIG_SNMP_V3_USER_NAME). main.c
# registers the authPriv admin at run time from SNMP_SAMPLE_V3_ADMIN_* and maps
# it to VACM group "admin" (fullView); it uses HMAC-SHA-256 + AES-128-CFB.
# Authentication protocol for the compile-time default user (unused here, but it
# documents which algorithms this build must provide).
CONFIG_SNMP_V3_AUTH_PROTOCOL_SHA256=y
# 0=none 1=AES-128-CFB
CONFIG_SNMP_V3_PRIV_PROTOCOL=1
CONFIG_SNMP_V3_ENGINE_BOOTS=1
CONFIG_SNMP_V3_MAX_USERS=4

# --- Notifications ----------------------------------------------------------
CONFIG_SNMP_TRAP_ENABLED=y
CONFIG_SNMP_TRAP_PORT=162
CONFIG_SNMP_TRAP_FORMAT_V3=y
CONFIG_SNMP_TRAP_V3_USER="v3admin"

# Sample application options
CONFIG_SNMP_SAMPLE_ENTERPRISE_ID=54321
CONFIG_SNMP_SAMPLE_SENSOR_OBJECT=y
CONFIG_SNMP_SAMPLE_LED_OBJECT=y
CONFIG_SNMP_SAMPLE_BUTTON_TRAP=y
CONFIG_SNMP_SAMPLE_TRAP_DEST="192.168.68.103"
CONFIG_SNMP_SAMPLE_V3_MONITOR_USER="v3monitor"
CONFIG_SNMP_SAMPLE_V3_MONITOR_AUTH_PASS="v3-monitor-auth-passphrase-test-only"

# --- Stack sizing -----------------------------------------------------------
# The v3 receive path runs inside the socket-service thread and holds one decoded
# struct snmp_v3_msg (plus the AES plaintext/ciphertext buffers) on its stack, so
# 4 KiB is not enough. Kconfig asks for >= 12 KiB whenever v3 or GetBulk is on.
# The shell and workqueue threads also need >= 16 KiB to send v3 traps safely.
CONFIG_NET_SOCKETS_SERVICE_STACK_SIZE=16384
CONFIG_MAIN_STACK_SIZE=8192
CONFIG_SYSTEM_WORKQUEUE_STACK_SIZE=16384
CONFIG_SHELL_STACK_SIZE=16384

CONFIG_LOG=y
CONFIG_LOG_MODE_IMMEDIATE=y
CONFIG_SNMP_LOG_LEVEL_INF=y

# Interactive shell over UART
CONFIG_SHELL=y
CONFIG_SHELL_BACKENDS=y
CONFIG_SHELL_BACKEND_SERIAL=y
CONFIG_NET_SHELL=y
```

## src/main.c
```c
/*
 * Copyright (c) 2026 Zephyr SNMP Contributors
 * SPDX-License-Identifier: Apache-2.0
 */

#include <zephyr/kernel.h>
#include <zephyr/device.h>
#include <zephyr/devicetree.h>
#include <zephyr/logging/log.h>
#include <zephyr/net/net_if.h>
#include <zephyr/net/net_mgmt.h>
#include <zephyr/net/net_event.h>
#include <zephyr/net/net_ip.h>
#include <errno.h>
#include <stdio.h>
#include <string.h>
#include <snmp/snmp.h>
#include <snmp/snmp_mib.h>
#include <snmp/snmp_trap.h>
#include <snmp/snmp_usm.h>
#include <snmp/snmp_vacm.h>
#include "app_led.h"
#include "app_sensor.h"
#include "app_button.h"
#include "app_mib.h"

LOG_MODULE_REGISTER(main, LOG_LEVEL_INF);

#ifndef CONFIG_SNMP_SAMPLE_ENTERPRISE_ID
#define CONFIG_SNMP_SAMPLE_ENTERPRISE_ID 54321
#endif

#ifndef CONFIG_SNMP_SAMPLE_TRAP_DEST
#define CONFIG_SNMP_SAMPLE_TRAP_DEST "192.168.16.100"
#endif

#ifndef CONFIG_SNMP_SAMPLE_V3_MONITOR_USER
#define CONFIG_SNMP_SAMPLE_V3_MONITOR_USER "v3monitor"
#endif

#ifndef CONFIG_SNMP_SAMPLE_V3_MONITOR_AUTH_PASS
#define CONFIG_SNMP_SAMPLE_V3_MONITOR_AUTH_PASS "v3-monitor-auth-passphrase-test-only"
#endif

#ifndef CONFIG_SNMP_AGENT_PORT
#define CONFIG_SNMP_AGENT_PORT 161
#endif

#ifndef CONFIG_SNMP_COMMUNITY_READ
#define CONFIG_SNMP_COMMUNITY_READ "public"
#endif

#ifndef CONFIG_SNMP_COMMUNITY_WRITE
#define CONFIG_SNMP_COMMUNITY_WRITE "private"
#endif

static struct net_mgmt_event_callback s_mgmt_cb;
static K_SEM_DEFINE(s_ip_ready_sem, 0, 1);
static struct net_if *s_snmp_iface;

/*
 * Caller-owned agent storage (decision #1 of the design contract): one instance is
 * always present; the optional second one demonstrates true multi-instance operation
 * on another UDP port with its own identity and its own MIB tree.
 */
static struct snmp_agent g_agent_lan;
#if defined(CONFIG_SNMP_SAMPLE_SECOND_INSTANCE)
static struct snmp_agent g_agent_wan;
#endif

#if defined(CONFIG_SNMP_VERSION_3) && defined(CONFIG_SNMP_STORAGE_EEPROM) && DT_HAS_ALIAS(eeprom_0)
static struct snmp_storage_eeprom_ctx s_lan_eeprom_ctx = {
	.dev = DEVICE_DT_GET(DT_ALIAS(eeprom_0)),
	.offset = 0,
};
static const struct snmp_storage s_lan_storage = {
	.read = snmp_storage_eeprom_read,
	.write = snmp_storage_eeprom_write,
	.ctx = &s_lan_eeprom_ctx,
};
#if defined(CONFIG_SNMP_SAMPLE_SECOND_INSTANCE)
static struct snmp_storage_eeprom_ctx s_wan_eeprom_ctx = {
	.dev = DEVICE_DT_GET(DT_ALIAS(eeprom_0)),
	.offset = SNMP_STORAGE_EEPROM_TOTAL_SIZE,
};
static const struct snmp_storage s_wan_storage = {
	.read = snmp_storage_eeprom_read,
	.write = snmp_storage_eeprom_write,
	.ctx = &s_wan_eeprom_ctx,
};
#endif
#endif

static void print_banner(const char *ip_str)
{
	LOG_INF("================================================================");
	LOG_INF("       SNMPv3 VALIDATION SAMPLE ON ZEPHYR RTOS (NUCLEO-H743ZI)   ");
	LOG_INF("================================================================");
	LOG_INF("Protocol Support:");
	LOG_INF("  - SNMPv1  : %s", IS_ENABLED(CONFIG_SNMP_VERSION_1) ? "ENABLED" : "DISABLED");
	LOG_INF("  - SNMPv2c : %s", IS_ENABLED(CONFIG_SNMP_VERSION_2C) ? "ENABLED" : "DISABLED");
	LOG_INF("  - SNMPv3  : %s", IS_ENABLED(CONFIG_SNMP_VERSION_3) ? "ENABLED" : "DISABLED");
	LOG_INF("Security & Network:");
	LOG_INF("  - Agent IP / Port : %s : %d", ip_str, CONFIG_SNMP_AGENT_PORT);
	LOG_INF("  - Read Community  : \"%s\" (v1/v2c)", CONFIG_SNMP_COMMUNITY_READ);
	LOG_INF("  - Write Community : \"%s\" (v1/v2c)", CONFIG_SNMP_COMMUNITY_WRITE);
#if defined(CONFIG_SNMP_VERSION_3)
	LOG_INF("  - v3 authPriv user: \"%s\" (SHA-256 / AES-128-CFB)",
		CONFIG_SNMP_SAMPLE_V3_ADMIN_USER);
	LOG_INF("  - v3 authNoPriv   : \"%s\" (SHA-1, read-only VACM group)",
		CONFIG_SNMP_SAMPLE_V3_MONITOR_USER);
	LOG_INF("  - engineBoots     : %u", (unsigned int)snmp_usm_get_engine_boots(&g_agent_lan));
	LOG_INF("  -- All credentials above are public test values. Never ship them. --");
#endif
#if defined(CONFIG_SNMP_SAMPLE_SECOND_INSTANCE)
	LOG_INF("  - Second instance: %s : %d (sysName \"%s\")", ip_str,
		CONFIG_SNMP_SAMPLE_WAN_PORT, "NUCLEO-H743ZI-WAN");
#endif
#if defined(CONFIG_SNMP_TRAP_ENABLED)
	LOG_INF("  - Trap Destination: %s : %d", CONFIG_SNMP_SAMPLE_TRAP_DEST,
		CONFIG_SNMP_TRAP_PORT);
#endif
	LOG_INF("Private MIB Structure (1.3.6.1.4.1.%d.1):", CONFIG_SNMP_SAMPLE_ENTERPRISE_ID);
	LOG_INF("  .1.1.1.0 sensorValue       (INTEGER, temp in C)   [R/W]");
	LOG_INF("  .1.1.2.0 ledState          (INTEGER, 0=OFF, 1=ON) [R/W]");
	LOG_INF("  .1.1.3.0 buttonCounter     (Counter32, press cnt) [RO]");
	LOG_INF("  .1.1.4.0 sensorHumidity    (Gauge32, %% relative)  [RO]");
	LOG_INF("  .1.1.5.0 sensorDescription (OCTET STRING)          [RO]");
	LOG_INF("  .1.1.6.0 sensorStatusOid   (OBJECT IDENTIFIER)    [RO]");
	LOG_INF("  .1.3.1 sensorTable       (Columns: idx, name, val)");
	LOG_INF("  .1.2.1 buttonPressed     (Notification/Trap)");
	LOG_INF("v3 validation commands (net-snmp):");
	LOG_INF("  snmpget -v3 -u %s -l authPriv -a SHA-256 -A '%s' -x AES -X '%s' %s \\",
		CONFIG_SNMP_SAMPLE_V3_ADMIN_USER, CONFIG_SNMP_SAMPLE_V3_ADMIN_AUTH_PASS,
		CONFIG_SNMP_SAMPLE_V3_ADMIN_PRIV_PASS, ip_str);
	LOG_INF("          1.3.6.1.4.1.%d.1.1.1.0", CONFIG_SNMP_SAMPLE_ENTERPRISE_ID);
	LOG_INF("  snmpwalk -v3 -u %s -l authNoPriv -a SHA -A '%s' %s 1.3.6.1.2.1.1",
		CONFIG_SNMP_SAMPLE_V3_MONITOR_USER, CONFIG_SNMP_SAMPLE_V3_MONITOR_AUTH_PASS,
		ip_str);
	LOG_INF("  snmpset -v3 -u %s -l authPriv -a SHA-256 -A '%s' -x AES -X '%s' %s \\",
		CONFIG_SNMP_SAMPLE_V3_ADMIN_USER, CONFIG_SNMP_SAMPLE_V3_ADMIN_AUTH_PASS,
		CONFIG_SNMP_SAMPLE_V3_ADMIN_PRIV_PASS, ip_str);
	LOG_INF("          1.3.6.1.4.1.%d.1.1.2.0 i 1", CONFIG_SNMP_SAMPLE_ENTERPRISE_ID);
	LOG_INF("  snmptrap -v3 -u %s -l authPriv -a SHA-256 -A '%s' -x AES -X '%s' %s '' \\",
		CONFIG_SNMP_SAMPLE_V3_ADMIN_USER, CONFIG_SNMP_SAMPLE_V3_ADMIN_AUTH_PASS,
		CONFIG_SNMP_SAMPLE_V3_ADMIN_PRIV_PASS, ip_str);
	LOG_INF("          1.3.6.1.6.3.1.1.5.1 1.3.6.1.2.1.1.3.0 t 0");
	LOG_INF("Expected v3 behaviour to verify:");
	LOG_INF("  - unknown engineID / user / wrong digest answers with a Report PDU");
	LOG_INF("  - 'v3monitor' can read 1.3.6.1.2.1.1 but not the private MIB subtree");
	LOG_INF("  - plain v2c still works on the same instance with the communities above");
	LOG_INF("================================================================");
}

#if defined(CONFIG_SNMP_VERSION_3)
/*
 * Register the authPriv demo account. The module intentionally ships no default
 * user, so the sample creates one at run time and maps it to the "admin" VACM group
 * that snmp_vacm_init() already provides (fullView for Read/Write/Notify).
 */
static int register_admin_user(struct snmp_agent *agent)
{
	struct snmp_usm_user admin = {
		.auth_protocol = SNMP_USM_AUTH_SHA256,
		.priv_protocol = SNMP_USM_PRIV_AES,
	};

	if (strlen(CONFIG_SNMP_SAMPLE_V3_ADMIN_USER) >= sizeof(admin.user_name) ||
	    strlen(CONFIG_SNMP_SAMPLE_V3_ADMIN_AUTH_PASS) >= sizeof(admin.auth_pass) ||
	    strlen(CONFIG_SNMP_SAMPLE_V3_ADMIN_PRIV_PASS) >= sizeof(admin.priv_pass)) {
		return -EINVAL;
	}

	strcpy(admin.user_name, CONFIG_SNMP_SAMPLE_V3_ADMIN_USER);
	strcpy(admin.auth_pass, CONFIG_SNMP_SAMPLE_V3_ADMIN_AUTH_PASS);
	strcpy(admin.priv_pass, CONFIG_SNMP_SAMPLE_V3_ADMIN_PRIV_PASS);

	int ret = snmp_usm_add_user(agent, &admin);
	if (ret < 0) {
		return ret;
	}

	return snmp_vacm_add_group_mapping(agent, SNMP_SEC_MODEL_USM,
					   CONFIG_SNMP_SAMPLE_V3_ADMIN_USER, "admin");
}

/*
 * Register the second demo user at run time. It is authNoPriv on purpose: the same
 * agent then serves an authPriv account (the compile-time default user) and an
 * authNoPriv one, which is what a validation sample has to exercise. snmp_vacm_init()
 * already mapped this name to group "readonly", so the account can read the system
 * group and nothing else.
 *
 * RFC 3414 section 11.2 requires >= 8-octet pass phrases; snmp_usm_add_user() rejects
 * anything shorter, so a Kconfig typo shows up here instead of as a silent auth failure.
 */
static int register_monitor_user(struct snmp_agent *agent)
{
	struct snmp_usm_user monitor = {
		.auth_protocol = SNMP_USM_AUTH_SHA1,
		.priv_protocol = SNMP_USM_PRIV_NONE,
	};

	if (strlen(CONFIG_SNMP_SAMPLE_V3_MONITOR_USER) >= sizeof(monitor.user_name) ||
	    strlen(CONFIG_SNMP_SAMPLE_V3_MONITOR_AUTH_PASS) >= sizeof(monitor.auth_pass)) {
		return -EINVAL;
	}

	strcpy(monitor.user_name, CONFIG_SNMP_SAMPLE_V3_MONITOR_USER);
	strcpy(monitor.auth_pass, CONFIG_SNMP_SAMPLE_V3_MONITOR_AUTH_PASS);

	int ret = snmp_usm_add_user(agent, &monitor);
	if (ret < 0) {

		return ret;
	}

	return snmp_vacm_add_group_mapping(agent, SNMP_SEC_MODEL_USM,
					   CONFIG_SNMP_SAMPLE_V3_MONITOR_USER, "readonly");
}
#endif /* CONFIG_SNMP_VERSION_3 */

static void net_event_handler(struct net_mgmt_event_callback *cb, uint64_t mgmt_event,
			      struct net_if *iface)
{
	ARG_UNUSED(cb);
	if (mgmt_event == NET_EVENT_IPV4_ADDR_ADD && iface == s_snmp_iface) {
		k_sem_give(&s_ip_ready_sem);
	}
}

#if defined(CONFIG_SHELL)
#include <zephyr/shell/shell.h>
#include <stdlib.h>

static int cmd_app_button(const struct shell *sh, size_t argc, char **argv)
{
	ARG_UNUSED(argc);
	ARG_UNUSED(argv);
	shell_print(sh, "Simulating User Button press...");
	app_button_simulate_press();
	shell_print(sh, "Button count now: %u", app_button_get_counter());
	return 0;
}

static int cmd_app_led(const struct shell *sh, size_t argc, char **argv)
{
	if (argc < 2) {
		shell_print(sh, "User LED state: %s (%d)", app_led_get_state() ? "ON" : "OFF",
			    app_led_get_state());
		return 0;
	}
	int val = atoi(argv[1]);
	if (val != 0 && val != 1) {

		shell_error(sh, "Invalid value %d. Must be 0 (OFF) or 1 (ON).", val);
		return -EINVAL;
	}
	app_led_set_state(val);
	shell_print(sh, "User LED set to: %s (%d)", val ? "ON" : "OFF", val);
	return 0;
}

static int cmd_app_sensor(const struct shell *sh, size_t argc, char **argv)
{
	ARG_UNUSED(argc);
	ARG_UNUSED(argv);
	shell_print(sh, "Sensor Readings:");
	shell_print(sh, "  Temperature : %d C", app_sensor_get_temp());
	shell_print(sh, "  Humidity    : %u %%", app_sensor_get_humidity());
	shell_print(sh, "  Description : %s", app_sensor_get_description());
	shell_print(sh, "  Button Count: %u", app_button_get_counter());
	shell_print(sh, "  LED State   : %d", app_led_get_state());
	return 0;
}

SHELL_STATIC_SUBCMD_SET_CREATE(
	sub_app,
	SHELL_CMD(button, NULL, "Simulate User Button press and send SNMP Trap", cmd_app_button),
	SHELL_CMD_ARG(led, NULL, "Get or set User LED [0|1]", cmd_app_led, 1, 1),
	SHELL_CMD(sensor, NULL, "Display current sensor and device values", cmd_app_sensor),
	SHELL_SUBCMD_SET_END);

SHELL_CMD_REGISTER(app, &sub_app, "SNMP validation sample commands", NULL);
#endif

int main(void)
{
	LOG_INF("Booting SNMP Validation Sample...");

	s_snmp_iface = net_if_get_first_ethernet();
	if (!s_snmp_iface) {
		LOG_ERR("No Ethernet network interface found");
		return -ENODEV;
	}

	/* 1. Initialize hardware drivers that do not need the agent */
	app_led_init();
	app_sensor_init();

	/* 2. Register network management event listener */
	net_mgmt_init_event_callback(&s_mgmt_cb, net_event_handler,
				     NET_EVENT_IPV4_ADDR_ADD | NET_EVENT_IPV4_ADDR_DEL);
	net_mgmt_add_event_callback(&s_mgmt_cb);

	/* 3. Create the LAN agent instance on caller-owned static storage.
	 *    snmp_agent_init() only builds the domain state (MIB-II groups, identity,
	 *    communities); the UDP listener is opened later by snmp_agent_start().
	 */
	const struct snmp_agent_cfg cfg_lan = {
		.port = CONFIG_SNMP_AGENT_PORT,
		.iface = s_snmp_iface,
		.read_community = CONFIG_SNMP_COMMUNITY_READ,
		.write_community = CONFIG_SNMP_COMMUNITY_WRITE,
		.sys_descr = "Zephyr RTOS SNMP Validation Node (STM32H743ZI)",
		.sys_contact = "admin@example.com",
		.sys_name = "NUCLEO-H743ZI-SNMP",
		.sys_location = "Lab Bench 1",
		.settings_prefix = "snmp/lan",
#if defined(CONFIG_SNMP_VERSION_3) && defined(CONFIG_SNMP_STORAGE_EEPROM) && DT_HAS_ALIAS(eeprom_0)
		.storage = &s_lan_storage,
#endif
	};
	int ret = snmp_agent_init(&g_agent_lan, &cfg_lan);
	if (ret < 0) {

		LOG_ERR("Failed to initialize LAN SNMP agent: %d", ret);
		return ret;
	}

#if defined(CONFIG_SNMP_VERSION_3)
	/* 3b. Add the demo accounts: authPriv admin (fullView) and authNoPriv monitor. */
	ret = register_admin_user(&g_agent_lan);
	if (ret < 0) {
		LOG_ERR("Failed to register USM admin user \"%s\": %d",
			CONFIG_SNMP_SAMPLE_V3_ADMIN_USER, ret);
		return ret;
	}
	ret = register_monitor_user(&g_agent_lan);
	if (ret < 0) {
		LOG_ERR("Failed to register USM monitor user \"%s\": %d",
			CONFIG_SNMP_SAMPLE_V3_MONITOR_USER, ret);
		return ret;
	}
	LOG_INF("Registered USM users: \"%s\" (authPriv), \"%s\" (authNoPriv)",
		CONFIG_SNMP_SAMPLE_V3_ADMIN_USER, CONFIG_SNMP_SAMPLE_V3_MONITOR_USER);

	/*
	 * The collector's createUser line needs this engine ID (RFC 3411 §5). Printing
	 * it once at boot removes the guessing that used to require trace output.
	 */
	{
		uint8_t engine_id[32];
		uint8_t engine_id_len = sizeof(engine_id);
		char engine_hex[2 * 32 + 3] = "?";
		int hex_pos = 0;

		if (snmp_usm_get_engine_id(&g_agent_lan, engine_id, &engine_id_len) == 0) {
			hex_pos = snprintf(engine_hex, sizeof(engine_hex), "0x");
			for (uint8_t i = 0;
			     i < engine_id_len && hex_pos < (int)sizeof(engine_hex) - 2; i++) {
				hex_pos +=
					snprintf(&engine_hex[hex_pos], sizeof(engine_hex) - hex_pos,
						 "%02X", engine_id[i]);
			}
		}
		LOG_INF("snmpEngineID: %s (use as -e in snmptrapd createUser)", engine_hex);
	}
#endif

	/* Button traps fire from a workqueue: hand it the agent to notify through. */
	app_button_init(&g_agent_lan);

	/* 4. Register Private MIB on the LAN agent */
	ret = app_mib_init(&g_agent_lan);
	if (ret < 0) {
		LOG_ERR("Failed to initialize Private MIB: %d", ret);
		return ret;
	}

#if defined(CONFIG_SNMP_TRAP_ENABLED)
	/* 5. Configure trap destination */
	snmp_trap_add_destination(&g_agent_lan, CONFIG_SNMP_SAMPLE_TRAP_DEST);
	LOG_INF("Configured SNMP Trap destination: %s", CONFIG_SNMP_SAMPLE_TRAP_DEST);
#endif

#if defined(CONFIG_SNMP_SAMPLE_SECOND_INSTANCE)
	/*
	 * 6. Second instance: same interface, different UDP port (two RUNNING agents
	 * cannot share :161 without an interface binding — plain socket semantics)
	 * and a distinct sysName. Its MIB tree, counters and community set are fully
	 * independent of g_agent_lan.
	 */
	const struct snmp_agent_cfg cfg_wan = {
		.port = CONFIG_SNMP_SAMPLE_WAN_PORT,
		.iface = s_snmp_iface,
		.read_community = CONFIG_SNMP_COMMUNITY_READ,
		.write_community = CONFIG_SNMP_COMMUNITY_WRITE,
		.sys_descr = "Zephyr RTOS SNMP Validation Node (WAN instance)",
		.sys_contact = "admin@example.com",
		.sys_name = "NUCLEO-H743ZI-WAN",
		.sys_location = "Lab Bench 1",
		.settings_prefix = "snmp/wan",
#if defined(CONFIG_SNMP_VERSION_3) && defined(CONFIG_SNMP_STORAGE_EEPROM) && DT_HAS_ALIAS(eeprom_0)
		.storage = &s_wan_storage,
#endif
	};
	ret = snmp_agent_init(&g_agent_wan, &cfg_wan);
	if (ret < 0) {
		LOG_ERR("Failed to initialize WAN SNMP agent: %d", ret);
		return ret;
	}
	ret = app_mib_init(&g_agent_wan);
	if (ret < 0) {
		LOG_ERR("Failed to register Private MIB on WAN agent: %d", ret);
		return ret;
	}
#endif

	/* Check if interface already has IP assigned; if not, wait for DHCP */
	struct net_if *iface = s_snmp_iface;
	bool has_ip = false;
	char ip_buf[NET_IPV4_ADDR_LEN] = "192.0.2.1";

	if (iface && iface->config.ip.ipv4) {
		for (int i = 0; i < NET_IF_MAX_IPV4_ADDR; i++) {
			if (iface->config.ip.ipv4->unicast[i].ipv4.is_used &&
			    iface->config.ip.ipv4->unicast[i].ipv4.address.in_addr.s_addr != 0) {
				net_addr_ntop(
					AF_INET,
					&iface->config.ip.ipv4->unicast[i].ipv4.address.in_addr,
					ip_buf, sizeof(ip_buf));
				has_ip = true;
				break;
			}
		}
	}

	if (!has_ip) {
		LOG_INF("Waiting for DHCP lease...");
		k_sem_take(&s_ip_ready_sem, K_FOREVER);
		if (iface && iface->config.ip.ipv4) {
			for (int i = 0; i < NET_IF_MAX_IPV4_ADDR; i++) {
				if (iface->config.ip.ipv4->unicast[i].ipv4.is_used) {
					net_addr_ntop(AF_INET,
						      &iface->config.ip.ipv4->unicast[i]
							       .ipv4.address.in_addr,
						      ip_buf, sizeof(ip_buf));
					break;
				}
			}
		}
	}

	print_banner(ip_buf);

	/* 7. Open the UDP listeners only now that the interface has an address.
	 *    The coldStart trap stays ordered exactly like the old transport facade
	 *    documented it (former snmp_service.c): first an assigned IPv4 address,
	 *    then the listener, then the notification.
	 */
	ret = snmp_agent_start(&g_agent_lan);
	if (ret < 0) {
		LOG_ERR("Failed to start LAN SNMP agent: %d", ret);
		return ret;
	}
#if defined(CONFIG_SNMP_SAMPLE_SECOND_INSTANCE)
	ret = snmp_agent_start(&g_agent_wan);
	if (ret < 0) {
		LOG_ERR("Failed to start WAN SNMP agent: %d", ret);
		return ret;
	}
#endif

#if defined(CONFIG_SNMP_TRAP_ENABLED)
	snmp_trap_send_coldstart(&g_agent_lan);
	LOG_INF("ColdStart Trap dispatched to %s", CONFIG_SNMP_SAMPLE_TRAP_DEST);
#endif

	/* 8. Main loop: periodically update sensor values */
	while (1) {
		k_sleep(K_SECONDS(2));
		app_sensor_update_periodic();
	}

	return 0;
}
```

## src/app_button.c
```c
/*
 * Copyright (c) 2026 Zephyr SNMP Contributors
 * SPDX-License-Identifier: Apache-2.0
 */

#include "app_button.h"
#include "app_led.h"
#include <zephyr/kernel.h>
#include <zephyr/drivers/gpio.h>
#include <zephyr/logging/log.h>
#include <snmp/snmp.h>
#include <snmp/snmp_trap.h>

LOG_MODULE_REGISTER(app_button, LOG_LEVEL_INF);

#ifndef CONFIG_SNMP_SAMPLE_ENTERPRISE_ID
#define CONFIG_SNMP_SAMPLE_ENTERPRISE_ID 54321
#endif

static uint32_t s_button_counter;

/* Agent to notify through; set by app_button_init() from main.c's storage. */
static struct snmp_agent *s_trap_agent;

#if DT_NODE_EXISTS(DT_ALIAS(sw0))
static const struct gpio_dt_spec s_btn = GPIO_DT_SPEC_GET(DT_ALIAS(sw0), gpios);
static struct gpio_callback s_btn_cb_data;
static bool s_hardware_available;
static int64_t s_last_press_time;

static void button_work_handler(struct k_work *work);
static K_WORK_DEFINE(s_button_work, button_work_handler);

static void button_isr(const struct device *dev, struct gpio_callback *cb, uint32_t pins)
{
	ARG_UNUSED(dev);
	ARG_UNUSED(cb);
	ARG_UNUSED(pins);

	int64_t now = k_uptime_get();
	if (now - s_last_press_time > 200) {

		s_last_press_time = now;
		k_work_submit(&s_button_work);
	}
}

static void button_work_handler(struct k_work *work)
{
	ARG_UNUSED(work);

	s_button_counter++;
	LOG_INF("==================================================");
	LOG_INF(">>> User Button Pressed! Total Count: %u <<<", s_button_counter);
	LOG_INF("==================================================");

#if defined(CONFIG_SNMP_TRAP_ENABLED)
	app_button_trigger_notification();
#else
	LOG_INF("SNMP Traps disabled in Kconfig (CONFIG_SNMP_TRAP_ENABLED=n)");
#endif
}
#endif

int app_button_init(struct snmp_agent *agent)
{
#if !defined(CONFIG_SNMP_TRAP_ENABLED)
	ARG_UNUSED(agent);
#endif
	s_trap_agent = agent;

#if DT_NODE_EXISTS(DT_ALIAS(sw0))
	if (!gpio_is_ready_dt(&s_btn)) {
		LOG_WRN("User Button device %s not ready", s_btn.port->name);
		return -ENODEV;
	}

	int ret = gpio_pin_configure_dt(&s_btn, GPIO_INPUT);
	if (ret < 0) {

		LOG_ERR("Failed to configure button pin: %d", ret);
		return ret;
	}

	ret = gpio_pin_interrupt_configure_dt(&s_btn, GPIO_INT_EDGE_TO_ACTIVE);
	if (ret < 0) {
		LOG_ERR("Failed to configure button interrupt: %d", ret);
		return ret;
	}

	gpio_init_callback(&s_btn_cb_data, button_isr, BIT(s_btn.pin));
	ret = gpio_add_callback(s_btn.port, &s_btn_cb_data);
	if (ret < 0) {
		LOG_ERR("Failed to add button callback: %d", ret);
		return ret;
	}

	s_hardware_available = true;
	LOG_INF("User Button initialized on %s pin %d (Interrupt active edge)", s_btn.port->name,
		s_btn.pin);
	return 0;
#else
	LOG_WRN("No 'sw0' alias found in DeviceTree; manual triggering available");
	return 0;
#endif
}

uint32_t app_button_get_counter(void)
{
	return s_button_counter;
}

int app_button_trigger_notification(void)
{
#if defined(CONFIG_SNMP_TRAP_ENABLED)
	/* Notification OID: 1.3.6.1.4.1.<enterprise>.1.2.1 (buttonPressed) */
	struct snmp_oid trap_oid = {
		.len = 9, .ids = {1, 3, 6, 1, 4, 1, CONFIG_SNMP_SAMPLE_ENTERPRISE_ID, 1, 2, 1}};

	struct snmp_varbind varbinds[2];

	/* Varbind 1: buttonCounter (1.3.6.1.4.1.<enterprise>.1.1.3.0) */
	varbinds[0].oid.len = 10;
	varbinds[0].oid.ids[0] = 1;
	varbinds[0].oid.ids[1] = 3;
	varbinds[0].oid.ids[2] = 6;
	varbinds[0].oid.ids[3] = 1;
	varbinds[0].oid.ids[4] = 4;
	varbinds[0].oid.ids[5] = 1;
	varbinds[0].oid.ids[6] = CONFIG_SNMP_SAMPLE_ENTERPRISE_ID;
	varbinds[0].oid.ids[7] = 1;
	varbinds[0].oid.ids[8] = 1;
	varbinds[0].oid.ids[9] = 3;
	varbinds[0].oid.ids[10] = 0;
	varbinds[0].oid.len = 11;
	varbinds[0].type = SNMP_TAG_COUNTER32;
	varbinds[0].val.uint_val = s_button_counter;

	/* Varbind 2: ledState (1.3.6.1.4.1.<enterprise>.1.1.2.0) */
	varbinds[1].oid.len = 10;
	varbinds[1].oid.ids[0] = 1;
	varbinds[1].oid.ids[1] = 3;
	varbinds[1].oid.ids[2] = 6;
	varbinds[1].oid.ids[3] = 1;
	varbinds[1].oid.ids[4] = 4;
	varbinds[1].oid.ids[5] = 1;
	varbinds[1].oid.ids[6] = CONFIG_SNMP_SAMPLE_ENTERPRISE_ID;
	varbinds[1].oid.ids[7] = 1;
	varbinds[1].oid.ids[8] = 1;
	varbinds[1].oid.ids[9] = 2;
	varbinds[1].oid.ids[10] = 0;
	varbinds[1].oid.len = 11;
	varbinds[1].type = ASN1_TAG_INTEGER;
	varbinds[1].val.int_val = app_led_get_state();

	int ret = snmp_trap_send(s_trap_agent, &trap_oid, varbinds, 2, false);
	if (ret < 0) {

		LOG_WRN("Failed to send button SNMP notification: %d", ret);
		return ret;
	}

	LOG_INF("SNMP Notification dispatched successfully (buttonCounter=%u, ledState=%d)",
		s_button_counter, varbinds[1].val.int_val);
	return 0;
#else
	LOG_WRN("SNMP Trap engine is disabled");
	return -ENOTSUP;
#endif
}

int app_button_simulate_press(void)
{
	s_button_counter++;
	LOG_INF(">>> Simulated Button Press! Total Count: %u <<<", s_button_counter);
	return app_button_trigger_notification();
}
```

## src/app_button.h
```c
/*
 * Copyright (c) 2026 Zephyr SNMP Contributors
 * SPDX-License-Identifier: Apache-2.0
 */

#ifndef APP_BUTTON_H_
#define APP_BUTTON_H_

#include <stdint.h>

struct snmp_agent;

#ifdef __cplusplus
extern "C" {
#endif

/**
 * @brief Initialize user button hardware (sw0 alias) with GPIO interrupt and workqueue.
 *
 * @param agent Agent through which a button press dispatches its SNMP notification.
 *              The caller owns the storage; it must outlive the module.
 * @return 0 on success, negative errno on failure.
 */
int app_button_init(struct snmp_agent *agent);

/**
 * @brief Get total user button press count.
 */
uint32_t app_button_get_counter(void);

/**
 * @brief Explicitly trigger the buttonPressed SNMP Trap/Notification.
 *        Can be called by button ISR or from shell / test code.
 * @return 0 on success, negative errno on failure.
 */
int app_button_trigger_notification(void);

/**
 * @brief Simulate button press (increments counter and triggers notification).
 * @return 0 on success, negative errno on failure.
 */
int app_button_simulate_press(void);

#ifdef __cplusplus
}
#endif

#endif /* APP_BUTTON_H_ */
```

## src/app_led.c
```c
/*
 * Copyright (c) 2026 Zephyr SNMP Contributors
 * SPDX-License-Identifier: Apache-2.0
 */

#include "app_led.h"
#include <zephyr/kernel.h>
#include <zephyr/drivers/gpio.h>
#include <zephyr/logging/log.h>

LOG_MODULE_REGISTER(app_led, LOG_LEVEL_INF);

#if DT_NODE_EXISTS(DT_ALIAS(led0))
static const struct gpio_dt_spec s_led = GPIO_DT_SPEC_GET(DT_ALIAS(led0), gpios);
static bool s_hardware_available;
#endif

static int s_led_state;

int app_led_init(void)
{
#if DT_NODE_EXISTS(DT_ALIAS(led0))
	if (!gpio_is_ready_dt(&s_led)) {
		LOG_WRN("User LED device %s not ready", s_led.port->name);
		return -ENODEV;
	}

	int ret = gpio_pin_configure_dt(&s_led, GPIO_OUTPUT_INACTIVE);
	if (ret < 0) {

		LOG_ERR("Failed to configure User LED pin: %d", ret);
		return ret;
	}

	s_hardware_available = true;
	s_led_state = 0;
	LOG_INF("User LED initialized on %s pin %d", s_led.port->name, s_led.pin);
	return 0;
#else
	LOG_WRN("No 'led0' alias found in DeviceTree; simulating LED in software");
	s_led_state = 0;
	return 0;
#endif
}

int app_led_get_state(void)
{
	return s_led_state;
}

int app_led_set_state(int state)
{
	if (state != 0 && state != 1) {
		LOG_WRN("Invalid LED state requested: %d (must be 0 or 1)", state);
		return -EINVAL;
	}

	s_led_state = state;

#if DT_NODE_EXISTS(DT_ALIAS(led0))
	if (s_hardware_available) {
		int ret = gpio_pin_set_dt(&s_led, state);
		if (ret < 0) {

			LOG_ERR("Failed to set physical LED pin: %d", ret);
			return ret;
		}
	}
#endif

	LOG_INF("Physical User LED changed to: %s (%d)", state ? "ON" : "OFF", state);
	return 0;
}
```

## src/app_led.h
```c
/*
 * Copyright (c) 2026 Zephyr SNMP Contributors
 * SPDX-License-Identifier: Apache-2.0
 */

#ifndef APP_LED_H_
#define APP_LED_H_

#include <stdbool.h>

#ifdef __cplusplus
extern "C" {
#endif

/**
 * @brief Initialize the user LED hardware (led0 alias).
 * @return 0 on success, negative errno on failure.
 */
int app_led_init(void);

/**
 * @brief Get the current state of the LED.
 * @return 1 if ON, 0 if OFF, negative errno on error.
 */
int app_led_get_state(void);

/**
 * @brief Set the LED state.
 * @param state 0 to turn OFF, 1 to turn ON.
 * @return 0 on success, -EINVAL if state is invalid, negative errno on hardware error.
 */
int app_led_set_state(int state);

#ifdef __cplusplus
}
#endif

#endif /* APP_LED_H_ */
```

## src/app_sensor.c
```c
/*
 * Copyright (c) 2026 Zephyr SNMP Contributors
 * SPDX-License-Identifier: Apache-2.0
 */

#include "app_sensor.h"
#include <zephyr/kernel.h>
#include <zephyr/logging/log.h>
#include <errno.h>

LOG_MODULE_REGISTER(app_sensor, LOG_LEVEL_INF);

static int32_t s_temperature = 25;
static uint32_t s_humidity = 55;
static const char *s_description = "NUCLEO-H743ZI Sensor Node";

static const char *s_table_names[] = {"CPU Temp", "Amb Humidity", "Core Voltage"};

static int32_t s_table_static_values[] = {25, 55, 3300};

int app_sensor_init(void)
{
	s_temperature = 25;
	s_humidity = 55;
	LOG_INF("Sensor module initialized (Initial Temp: %d C, Hum: %u%%)", s_temperature,
		s_humidity);
	return 0;
}

int32_t app_sensor_get_temp(void)
{
	return s_temperature;
}

void app_sensor_set_temp(int32_t temp)
{
	s_temperature = temp;
	LOG_INF("Simulated temperature updated to %d C", s_temperature);
}

uint32_t app_sensor_get_humidity(void)
{
	return s_humidity;
}

const char *app_sensor_get_description(void)
{
	return s_description;
}

int app_sensor_get_table_entry(uint32_t index, const char **name, int32_t *value)
{
	if (index < 1 || index > 3) {
		return -ENOENT;
	}

	if (name) {
		*name = s_table_names[index - 1];
	}
	if (value) {
		if (index == 1) {
			*value = s_temperature;
		} else if (index == 2) {
			*value = (int32_t)s_humidity;
		} else {
			*value = s_table_static_values[index - 1];
		}
	}
	return 0;
}

void app_sensor_update_periodic(void)
{
	/* Vary temperature between 22 and 36 C based on uptime */
	uint32_t uptime_sec = (uint32_t)(k_uptime_get() / 1000);
	s_temperature = 22 + (int32_t)(uptime_sec % 15);

	/* Vary humidity between 45% and 65% */
	s_humidity = 45 + (uptime_sec * 3 % 21);
}
```
