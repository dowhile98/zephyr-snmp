## CMakeLists.txt
```
# Copyright (c) 2026 StructCore Embedded
# SPDX-License-Identifier: Apache-2.0

cmake_minimum_required(VERSION 3.20.0)

list(APPEND EXTRA_ZEPHYR_MODULES "${CMAKE_CURRENT_SOURCE_DIR}/..")

find_package(Zephyr REQUIRED HINTS $ENV{ZEPHYR_BASE})
project(snmp_ztests)

target_include_directories(app PRIVATE ${CMAKE_CURRENT_SOURCE_DIR}/../include)

target_sources(app PRIVATE
    src/main.c
    src/test_ber.c
    src/test_oid.c
    src/test_mib.c
    src/test_mib2.c
    src/test_multi_instance.c
    src/test_set_2pc.c
    src/test_vacm.c
    src/test_usm.c
    src/test_trap.c
)
```

## Kconfig
```
# Copyright (c) 2026 StructCore Embedded
# SPDX-License-Identifier: Apache-2.0

mainmenu "DGUS2 Protocol Unit Tests"

config ZTEST_NEW_API
	bool "Compatibility symbol for Ztest New API"
	default y
	help
	  Compatibility symbol for legacy ZTEST_NEW_API configuration.

source "Kconfig.zephyr"
```

## prj.conf
```kconfig
CONFIG_ZTEST=y
CONFIG_LOG=y

# Networking dependencies for snmp module
CONFIG_NETWORKING=y
CONFIG_NET_UDP=y
CONFIG_NET_SOCKETS=y
CONFIG_NET_SOCKETS_SERVICE=y
CONFIG_NET_IPV4=y

# SNMP Subsystem
CONFIG_SNMP=y
CONFIG_SNMP_VERSION_1=y
CONFIG_SNMP_VERSION_2C=y
CONFIG_SNMP_VERSION_3=y
# The ztests exercise the SET path; the module default is off (read-only device).
CONFIG_SNMP_SET_ENABLE=y
# The module ships no default user; the ztests need one to sign messages with.
CONFIG_SNMP_V3_USER_NAME="ztest-user"
CONFIG_SNMP_V3_AUTH_PASS="ztest-auth-passphrase"
CONFIG_SNMP_V3_PRIV_PASS="ztest-priv-passphrase"
CONFIG_SNMP_MAX_INSTANCES=2
CONFIG_ZVFS_POLL_MAX=5
CONFIG_SNMP_MAX_MIB_NODES=128
CONFIG_SNMP_MAX_TABLES=8
CONFIG_SNMP_MAX_IFACES=8
CONFIG_SNMP_TRAP_ENABLED=y
CONFIG_SNMP_TRAP_DEST_COUNT=4
CONFIG_EEPROM=y

CONFIG_MAIN_STACK_SIZE=4096

# The v3 receive path keeps a decoded struct snmp_v3_msg (~8.8 KiB with the default
# CONFIG_SNMP_MAX_PDU_SIZE) plus the plaintext/ciphertext scratch on the stack, and the
# USM tests hold two such messages at once. The ztest thread stack must cover that.
CONFIG_ZTEST_STACK_SIZE=32768
```

## src/main.c
```c
/*
 * Copyright (c) 2026 StructCore Embedded
 * SPDX-License-Identifier: Apache-2.0
 */

#include <zephyr/ztest.h>

ZTEST_SUITE(snmp_ber, NULL, NULL, NULL, NULL, NULL);
ZTEST_SUITE(snmp_oid, NULL, NULL, NULL, NULL, NULL);
ZTEST_SUITE(snmp_mib, NULL, NULL, NULL, NULL, NULL);
ZTEST_SUITE(snmp_mib2, NULL, NULL, NULL, NULL, NULL);
ZTEST_SUITE(snmp_multi_instance, NULL, NULL, NULL, NULL, NULL);
ZTEST_SUITE(snmp_set_2pc, NULL, NULL, NULL, NULL, NULL);
ZTEST_SUITE(snmp_vacm, NULL, NULL, NULL, NULL, NULL);
ZTEST_SUITE(snmp_usm, NULL, NULL, NULL, NULL, NULL);
ZTEST_SUITE(snmp_trap, NULL, NULL, NULL, NULL, NULL);
```

## src/test_ber.c
```c
/*
 * Copyright (c) 2026 StructCore Embedded
 * SPDX-License-Identifier: Apache-2.0
 *
 * BER Encode/Decode Unit Tests
 */

#include <stdio.h>
#include <stdlib.h>
#include <string.h>
#include <errno.h>
#include <zephyr/ztest.h>
#include <snmp/snmp_ber.h>

#define BUF_SIZE           256
#define ASSERT(c)          zassert_true(c, #c)
#define ASSERT_EQ(a, b)    zassert_equal(a, b, NULL)
#define ASSERT_NE(a, b)    zassert_not_equal(a, b, NULL)
#define ASSERT_GT(a, b)    zassert_true((a) > (b), NULL)
#define ASSERT_LT(a, b)    zassert_true((a) < (b), NULL)
#define ASSERT_STREQ(a, b) zassert_mem_equal(a, b, strlen(b), NULL)

ZTEST(snmp_ber, test_ber_integer_roundtrip)
{
	uint8_t buf[BUF_SIZE];
	size_t off = 0;
	int32_t values[] = {0, 1, -1, 127, -128, 32767, -32768, 2147483647, -2147483648};

	for (int i = 0; i < 9; i++) {
		off = 0;
		int ret = snmp_ber_encode_int(buf, BUF_SIZE, &off, ASN1_TAG_INTEGER, values[i]);
		ASSERT_EQ(ret, 0);

		size_t dec_off = 0;
		int32_t decoded;
		ret = snmp_ber_decode_int(buf, off, &dec_off, &decoded);

		ASSERT_EQ(ret, 0);
		ASSERT_EQ(decoded, values[i]);
	}
}

ZTEST(snmp_ber, test_ber_octet_string_roundtrip)
{
	uint8_t buf[BUF_SIZE];
	size_t off = 0;

	const uint8_t test_data[] = "Hello SNMP";
	int ret = snmp_ber_encode_octet_string(buf, BUF_SIZE, &off, ASN1_TAG_OCTET_STRING,
					       test_data, 10);
	ASSERT_EQ(ret, 0);

	size_t dec_off = 0;
	uint8_t decoded[128];
	uint16_t decoded_len;
	memset(decoded, 0, sizeof(decoded));

	ret = snmp_ber_decode_octet_string(buf, off, &dec_off, decoded, sizeof(decoded),
					   &decoded_len);
	ASSERT_EQ(ret, 0);
	ASSERT_EQ(decoded_len, 10);
	ASSERT(memcmp(decoded, test_data, 10) == 0);
}

ZTEST(snmp_ber, test_ber_oid_roundtrip)
{
	uint8_t buf[BUF_SIZE];
	size_t off = 0;

	struct snmp_oid oid = {.len = 10, .ids = {1, 3, 6, 1, 2, 1, 1, 1, 0, 0}};

	int ret = snmp_ber_encode_oid(buf, BUF_SIZE, &off, &oid);
	ASSERT_EQ(ret, 0);

	size_t dec_off = 0;
	struct snmp_oid decoded = {0};
	ret = snmp_ber_decode_oid(buf, off, &dec_off, &decoded);

	ASSERT_EQ(ret, 0);
	ASSERT_EQ(decoded.len, 10);
	for (int i = 0; i < 10; i++) {
		ASSERT_EQ(decoded.ids[i], oid.ids[i]);
	}
}

ZTEST(snmp_ber, test_ber_uint32_roundtrip)
{
	uint8_t buf[BUF_SIZE];
	size_t off = 0;

	uint32_t values[] = {0, 1, 127, 128, 255, 256, 65535, 4294967295U};

	for (int i = 0; i < 8; i++) {
		off = 0;
		int ret = snmp_ber_encode_uint(buf, BUF_SIZE, &off, SNMP_TAG_COUNTER32, values[i]);
		ASSERT_EQ(ret, 0);

		size_t dec_off = 0;
		uint32_t decoded;
		ret = snmp_ber_decode_uint(buf, off, &dec_off, &decoded);

		ASSERT_EQ(ret, 0);
		ASSERT_EQ(decoded, values[i]);
	}
}

ZTEST(snmp_ber, test_ber_uint64_roundtrip)
{
	uint8_t buf[BUF_SIZE];
	size_t off = 0;

	uint64_t values[] = {0, 1, 4294967296ULL, 18446744073709551615ULL};

	for (int i = 0; i < 4; i++) {
		off = 0;
		int ret =
			snmp_ber_encode_uint64(buf, BUF_SIZE, &off, SNMP_TAG_COUNTER64, values[i]);
		ASSERT_EQ(ret, 0);

		size_t dec_off = 0;
		uint64_t decoded;
		ret = snmp_ber_decode_uint64(buf, off, &dec_off, &decoded);

		ASSERT_EQ(ret, 0);
		ASSERT_EQ(decoded, values[i]);
	}
}

ZTEST(snmp_ber, test_ber_null_roundtrip)
{
	uint8_t buf[BUF_SIZE];
	size_t off = 0;

	int ret = snmp_ber_encode_null(buf, BUF_SIZE, &off, ASN1_TAG_NULL);
	ASSERT_EQ(ret, 0);

	ASSERT_EQ(off, 2);
	ASSERT_EQ(buf[0], ASN1_TAG_NULL);
	ASSERT_EQ(buf[1], 0);
}

ZTEST(snmp_ber, test_ber_sequence_roundtrip)
{
	uint8_t buf[BUF_SIZE];
	size_t off = 0;
	uint8_t inner[] = {0x02, 0x01, 0x05};

	int ret = snmp_ber_encode_header(buf, BUF_SIZE, &off, ASN1_TAG_SEQUENCE, sizeof(inner));
	ASSERT_EQ(ret, 0);

	memcpy(&buf[off], inner, sizeof(inner));
	off += sizeof(inner);

	size_t dec_off = 0;
	uint8_t tag;
	size_t len;
	ret = snmp_ber_decode_header(buf, 256, &dec_off, &tag, &len);

	ASSERT_EQ(ret, 0);
	ASSERT_EQ(tag, ASN1_TAG_SEQUENCE);
	ASSERT_EQ(len, sizeof(inner));
}

ZTEST(snmp_ber, test_ber_decode_malformed_header)
{
	uint8_t tag;
	size_t len;
	size_t off;

	off = 0;
	int ret = snmp_ber_decode_header(NULL, 0, &off, &tag, &len);
	ASSERT_EQ(ret, -EINVAL);

	/* Indefinite length 0x80 is prohibited per RFC 1157 §3.2.1 & RFC 3416 §3 */
	uint8_t indef_buf[] = {0x30, 0x80, 0x00, 0x00};
	off = 0;

	ret = snmp_ber_decode_header(indef_buf, sizeof(indef_buf), &off, &tag, &len);
	ASSERT_EQ(ret, -EBADMSG);

	uint8_t short_buf[] = {0x02, 0x82};
	off = 0;

	ret = snmp_ber_decode_header(short_buf, 2, &off, &tag, &len);
	ASSERT_EQ(ret, -EBADMSG);

	uint8_t trunc_len_buf[] = {0x30, 0x82, 0x01};
	off = 0;

	ret = snmp_ber_decode_header(trunc_len_buf, sizeof(trunc_len_buf), &off, &tag, &len);
	ASSERT_EQ(ret, -EBADMSG);

	uint8_t long_form_buf[] = {0x02, 0x85, 0x01, 0x02, 0x03, 0x04, 0x05};
	off = 0;

	ret = snmp_ber_decode_header(long_form_buf, 7, &off, &tag, &len);
	ASSERT_EQ(ret, -EBADMSG);

	/* Tag only: missing length byte entirely */
	uint8_t tag_only_buf[] = {0x30};
	off = 0;

	ret = snmp_ber_decode_header(tag_only_buf, 1, &off, &tag, &len);
	ASSERT_EQ(ret, -EINVAL);

	/* 0x80 indefinite length with minimal 2-byte buffer */
	uint8_t indef_2byte[] = {0x02, 0x80};
	off = 0;

	ret = snmp_ber_decode_header(indef_2byte, 2, &off, &tag, &len);
	ASSERT_EQ(ret, -EBADMSG);

	/* 0x83 specifies 3 length octets, but only 2 present in buffer */
	uint8_t trunc_len_3[] = {0x30, 0x83, 0x01, 0x02};
	off = 0;

	ret = snmp_ber_decode_header(trunc_len_3, sizeof(trunc_len_3), &off, &tag, &len);
	ASSERT_EQ(ret, -EBADMSG);
}

ZTEST(snmp_ber, test_ber_decode_truncated_packet)
{
	uint8_t truncated[] = {0x02, 0x04, 0x00, 0x00};
	size_t off = 0;
	uint8_t tag;
	size_t len;

	int ret = snmp_ber_decode_header(truncated, 4, &off, &tag, &len);
	ASSERT_EQ(ret, -EBADMSG);

	/* Octet string claiming 5 bytes with only 2 bytes payload */
	uint8_t trunc_payload[] = {0x04, 0x05, 0x01, 0x02};
	off = 0;

	ret = snmp_ber_decode_header(trunc_payload, sizeof(trunc_payload), &off, &tag, &len);
	ASSERT_EQ(ret, -EBADMSG);
}

ZTEST(snmp_ber, test_ber_encode_buffer_overflow)
{
	uint8_t tiny_buf[2];
	size_t off = 0;

	int ret = snmp_ber_encode_int(tiny_buf, 2, &off, ASN1_TAG_INTEGER, 12345);
	ASSERT_EQ(ret, -ENOBUFS);
}
```

## src/test_mib2.c
```c
/*
 * Copyright (c) 2026 StructCore Embedded
 * SPDX-License-Identifier: Apache-2.0
 *
 * MIB-II Network Subsystem Unit Tests (RFC 1213 / RFC 2863)
 */

#include <stdio.h>
#include <stdlib.h>
#include <string.h>
#include <errno.h>
#include <zephyr/ztest.h>
#include <snmp/snmp.h>
#include <snmp/snmp_mib2.h>

#define ASSERT(c)          zassert_true(c, #c)
#define ASSERT_EQ(a, b)    zassert_equal(a, b, NULL)
#define ASSERT_NE(a, b)    zassert_not_equal(a, b, NULL)
#define ASSERT_GT(a, b)    zassert_true((a) > (b), NULL)
#define ASSERT_LT(a, b)    zassert_true((a) < (b), NULL)
#define ASSERT_STREQ(a, b) zassert_mem_equal(a, b, strlen(b), NULL)

#if defined(__ZEPHYR__)
struct snmp_mock_iface {
	uint32_t index;
	const char *descr;
	uint32_t type;
	uint32_t mtu;
	uint32_t speed;
	uint8_t mac[6];
	uint32_t admin_status;
	uint32_t oper_status;
	uint32_t in_octets;
	uint32_t in_ucast;
	uint32_t in_errors;
	uint32_t out_octets;
	uint32_t out_ucast;
	uint32_t out_errors;
};

void snmp_mib2_mock_set_ifaces(const struct snmp_mock_iface *ifaces, size_t count);
#endif

static struct snmp_agent s_agent;

static const struct snmp_mock_iface s_test_ifaces[2] = {
	{
		.index = 1,
		.descr = "eth0",
		.type = 6, /* ethernetCsmacd */
		.mtu = 1500,
		.speed = 100000000,
		.mac = {0x00, 0x11, 0x22, 0x33, 0x44, 0x55},
		.admin_status = 1, /* up */
		.oper_status = 1,  /* up */
		.in_octets = 1000,
		.in_ucast = 10,
		.in_errors = 1,
		.out_octets = 2000,
		.out_ucast = 20,
		.out_errors = 2,
	},
	{
		.index = 2,
		.descr = "lo0",
		.type = 24, /* softwareLoopback */
		.mtu = 65535,
		.speed = 10000000,
		.mac = {0x00, 0x00, 0x00, 0x00, 0x00, 0x00},
		.admin_status = 1,
		.oper_status = 1,
		.in_octets = 500,
		.in_ucast = 5,
		.in_errors = 0,
		.out_octets = 500,
		.out_ucast = 5,
		.out_errors = 0,
	},
};

ZTEST(snmp_mib2, test_mib2_interfaces_group)
{
	int ret;
	struct snmp_varbind vb;

	ret = snmp_agent_init(&s_agent, NULL);
	ASSERT_EQ(ret, 0);

	snmp_mib2_mock_set_ifaces(s_test_ifaces, 2);

	ret = snmp_mib2_register_interfaces(&s_agent);
	ASSERT_EQ(ret, 0);

	/* 1. Test ifNumber.0 (1.3.6.1.2.1.2.1.0) */
	struct snmp_oid oid_ifnumber = {
		.len = 9,
		.ids = {1, 3, 6, 1, 2, 1, 2, 1, 0},
	};
	memset(&vb, 0, sizeof(vb));
	ret = snmp_mib_get(&s_agent, &oid_ifnumber, &vb);
	ASSERT_EQ(ret, 0);
	ASSERT_EQ(vb.type, ASN1_TAG_INTEGER);
	ASSERT_EQ(vb.val.int_val, 2);

	/* 2. Test ifTable GET col 1 (index), row 1: 1.3.6.1.2.1.2.2.1.1.1 */
	struct snmp_oid oid_c1_r1 = {
		.len = 11,
		.ids = {1, 3, 6, 1, 2, 1, 2, 2, 1, 1, 1},
	};
	memset(&vb, 0, sizeof(vb));
	ret = snmp_mib_get(&s_agent, &oid_c1_r1, &vb);
	ASSERT_EQ(ret, 0);
	ASSERT_EQ(vb.type, ASN1_TAG_INTEGER);
	ASSERT_EQ(vb.val.int_val, 1);

	/* 3. Test ifTable GET col 2 (descr "eth0"), row 1: 1.3.6.1.2.1.2.2.1.2.1 */
	struct snmp_oid oid_c2_r1 = {
		.len = 11,
		.ids = {1, 3, 6, 1, 2, 1, 2, 2, 1, 2, 1},
	};
	memset(&vb, 0, sizeof(vb));
	ret = snmp_mib_get(&s_agent, &oid_c2_r1, &vb);
	ASSERT_EQ(ret, 0);
	ASSERT_EQ(vb.type, ASN1_TAG_OCTET_STRING);
	ASSERT_EQ(vb.val.octet_str.len, 4);
	ASSERT_EQ(memcmp(vb.val.octet_str.data, "eth0", 4), 0);

	/* 4. Test ifTable GET col 6 (MAC), row 1: 1.3.6.1.2.1.2.2.1.6.1 */
	struct snmp_oid oid_c6_r1 = {
		.len = 11,
		.ids = {1, 3, 6, 1, 2, 1, 2, 2, 1, 6, 1},
	};
	memset(&vb, 0, sizeof(vb));
	ret = snmp_mib_get(&s_agent, &oid_c6_r1, &vb);
	ASSERT_EQ(ret, 0);
	ASSERT_EQ(vb.type, ASN1_TAG_OCTET_STRING);
	ASSERT_EQ(vb.val.octet_str.len, 6);
	ASSERT_EQ(memcmp(vb.val.octet_str.data, s_test_ifaces[0].mac, 6), 0);

	/* 5. Test ifTable GET col 10 (in_octets), row 1: 1.3.6.1.2.1.2.2.1.10.1 */
	struct snmp_oid oid_c10_r1 = {
		.len = 11,
		.ids = {1, 3, 6, 1, 2, 1, 2, 2, 1, 10, 1},
	};
	memset(&vb, 0, sizeof(vb));
	ret = snmp_mib_get(&s_agent, &oid_c10_r1, &vb);
	ASSERT_EQ(ret, 0);
	ASSERT_EQ(vb.type, SNMP_TAG_COUNTER32);
	ASSERT_EQ(vb.val.uint_val, 1000);

	/* 6. Test row 2: col 1 (index 2), col 2 ("lo0") */
	struct snmp_oid oid_c1_r2 = {
		.len = 11,
		.ids = {1, 3, 6, 1, 2, 1, 2, 2, 1, 1, 2},
	};
	memset(&vb, 0, sizeof(vb));
	ret = snmp_mib_get(&s_agent, &oid_c1_r2, &vb);
	ASSERT_EQ(ret, 0);
	ASSERT_EQ(vb.type, ASN1_TAG_INTEGER);
	ASSERT_EQ(vb.val.int_val, 2);

	struct snmp_oid oid_c2_r2 = {
		.len = 11,
		.ids = {1, 3, 6, 1, 2, 1, 2, 2, 1, 2, 2},
	};
	memset(&vb, 0, sizeof(vb));
	ret = snmp_mib_get(&s_agent, &oid_c2_r2, &vb);
	ASSERT_EQ(ret, 0);
	ASSERT_EQ(vb.type, ASN1_TAG_OCTET_STRING);
	ASSERT_EQ(vb.val.octet_str.len, 3);
	ASSERT_EQ(memcmp(vb.val.octet_str.data, "lo0", 3), 0);

	/* 7. Test GETNEXT progression across columns and rows */
	/* From 1.3.6.1.2.1.2.2.1 -> next should be col 1, row 1 */
	struct snmp_oid cur_oid = {
		.len = 9,
		.ids = {1, 3, 6, 1, 2, 1, 2, 2, 1},
	};
	memset(&vb, 0, sizeof(vb));
	ret = snmp_mib_get_next(&s_agent, &cur_oid, &vb);
	ASSERT_EQ(ret, 0);
	ASSERT_EQ(snmp_oid_equal(&vb.oid, &oid_c1_r1), 1);
	ASSERT_EQ(vb.val.int_val, 1);

	/* Next from col 1, row 1 -> col 1, row 2 */
	cur_oid = vb.oid;
	memset(&vb, 0, sizeof(vb));
	ret = snmp_mib_get_next(&s_agent, &cur_oid, &vb);
	ASSERT_EQ(ret, 0);
	ASSERT_EQ(snmp_oid_equal(&vb.oid, &oid_c1_r2), 1);
	ASSERT_EQ(vb.val.int_val, 2);

	/* Next from col 1, row 2 -> col 2, row 1 */
	cur_oid = vb.oid;
	memset(&vb, 0, sizeof(vb));
	ret = snmp_mib_get_next(&s_agent, &cur_oid, &vb);
	ASSERT_EQ(ret, 0);
	ASSERT_EQ(snmp_oid_equal(&vb.oid, &oid_c2_r1), 1);
	ASSERT_EQ(vb.val.octet_str.len, 4);

	/* Next from col 2, row 1 -> col 2, row 2 */
	cur_oid = vb.oid;
	memset(&vb, 0, sizeof(vb));
	ret = snmp_mib_get_next(&s_agent, &cur_oid, &vb);
	ASSERT_EQ(ret, 0);
	ASSERT_EQ(snmp_oid_equal(&vb.oid, &oid_c2_r2), 1);
	ASSERT_EQ(vb.val.octet_str.len, 3);
}

ZTEST(snmp_mib2, test_mib2_ip_group)
{
	int ret;
	struct snmp_varbind vb;

	ret = snmp_agent_init(&s_agent, NULL);
	ASSERT_EQ(ret, 0);

	ret = snmp_mib2_register_ip(&s_agent);
	ASSERT_EQ(ret, 0);

	/* ipForwarding.0 (1.3.6.1.2.1.4.1.0) */
	struct snmp_oid oid_fwd = {
		.len = 9,
		.ids = {1, 3, 6, 1, 2, 1, 4, 1, 0},
	};
	memset(&vb, 0, sizeof(vb));
	ret = snmp_mib_get(&s_agent, &oid_fwd, &vb);
	ASSERT_EQ(ret, 0);
	ASSERT_EQ(vb.type, ASN1_TAG_INTEGER);
	ASSERT_EQ(vb.val.int_val, 2);

	/* ipDefaultTTL.0 (1.3.6.1.2.1.4.2.0) */
	struct snmp_oid oid_ttl = {
		.len = 9,
		.ids = {1, 3, 6, 1, 2, 1, 4, 2, 0},
	};
	memset(&vb, 0, sizeof(vb));
	ret = snmp_mib_get(&s_agent, &oid_ttl, &vb);
	ASSERT_EQ(ret, 0);
	ASSERT_EQ(vb.type, ASN1_TAG_INTEGER);
	ASSERT_EQ(vb.val.int_val, 64);

	/* ipInReceives.0 (1.3.6.1.2.1.4.3.0) */
	struct snmp_oid oid_in_recv = {
		.len = 9,
		.ids = {1, 3, 6, 1, 2, 1, 4, 3, 0},
	};
	memset(&vb, 0, sizeof(vb));
	ret = snmp_mib_get(&s_agent, &oid_in_recv, &vb);
	ASSERT_EQ(ret, 0);
	ASSERT_EQ(vb.type, SNMP_TAG_COUNTER32);
	ASSERT_EQ(vb.val.uint_val, 100);

	/* ipInDelivers.0 (1.3.6.1.2.1.4.9.0) */
	struct snmp_oid oid_in_deliv = {
		.len = 9,
		.ids = {1, 3, 6, 1, 2, 1, 4, 9, 0},
	};
	memset(&vb, 0, sizeof(vb));
	ret = snmp_mib_get(&s_agent, &oid_in_deliv, &vb);
	ASSERT_EQ(ret, 0);
	ASSERT_EQ(vb.type, SNMP_TAG_COUNTER32);
	ASSERT_EQ(vb.val.uint_val, 100);

	/* ipOutRequests.0 (1.3.6.1.2.1.4.10.0) */
	struct snmp_oid oid_out_req = {
		.len = 9,
		.ids = {1, 3, 6, 1, 2, 1, 4, 10, 0},
	};
	memset(&vb, 0, sizeof(vb));
	ret = snmp_mib_get(&s_agent, &oid_out_req, &vb);
	ASSERT_EQ(ret, 0);
	ASSERT_EQ(vb.type, SNMP_TAG_COUNTER32);
	ASSERT_EQ(vb.val.uint_val, 50);
}

ZTEST(snmp_mib2, test_mib2_icmp_group)
{
	int ret;
	struct snmp_varbind vb;

	ret = snmp_agent_init(&s_agent, NULL);
	ASSERT_EQ(ret, 0);

	ret = snmp_mib2_register_icmp(&s_agent);
	ASSERT_EQ(ret, 0);

	/* icmpInMsgs.0 (1.3.6.1.2.1.5.1.0) */
	struct snmp_oid oid_in_msgs = {
		.len = 9,
		.ids = {1, 3, 6, 1, 2, 1, 5, 1, 0},
	};
	memset(&vb, 0, sizeof(vb));
	ret = snmp_mib_get(&s_agent, &oid_in_msgs, &vb);
	ASSERT_EQ(ret, 0);
	ASSERT_EQ(vb.type, SNMP_TAG_COUNTER32);
	ASSERT_EQ(vb.val.uint_val, 10);

	/* icmpInErrors.0 (1.3.6.1.2.1.5.2.0) */
	struct snmp_oid oid_in_err = {
		.len = 9,
		.ids = {1, 3, 6, 1, 2, 1, 5, 2, 0},
	};
	memset(&vb, 0, sizeof(vb));
	ret = snmp_mib_get(&s_agent, &oid_in_err, &vb);
	ASSERT_EQ(ret, 0);
	ASSERT_EQ(vb.type, SNMP_TAG_COUNTER32);
	ASSERT_EQ(vb.val.uint_val, 0);

	/* icmpInDestUnreachs.0 (1.3.6.1.2.1.5.3.0) */
	struct snmp_oid oid_in_unreach = {
		.len = 9,
		.ids = {1, 3, 6, 1, 2, 1, 5, 3, 0},
	};
	memset(&vb, 0, sizeof(vb));
	ret = snmp_mib_get(&s_agent, &oid_in_unreach, &vb);
	ASSERT_EQ(ret, 0);
	ASSERT_EQ(vb.type, SNMP_TAG_COUNTER32);
	ASSERT_EQ(vb.val.uint_val, 1);

	/* icmpInEchos.0 (1.3.6.1.2.1.5.8.0) */
	struct snmp_oid oid_in_echo = {
		.len = 9,
		.ids = {1, 3, 6, 1, 2, 1, 5, 8, 0},
	};
	memset(&vb, 0, sizeof(vb));
	ret = snmp_mib_get(&s_agent, &oid_in_echo, &vb);
	ASSERT_EQ(ret, 0);
	ASSERT_EQ(vb.type, SNMP_TAG_COUNTER32);
	ASSERT_EQ(vb.val.uint_val, 8);

	/* icmpOutMsgs.0 (1.3.6.1.2.1.5.14.0) */
	struct snmp_oid oid_out_msgs = {
		.len = 9,
		.ids = {1, 3, 6, 1, 2, 1, 5, 14, 0},
	};
	memset(&vb, 0, sizeof(vb));
	ret = snmp_mib_get(&s_agent, &oid_out_msgs, &vb);
	ASSERT_EQ(ret, 0);
	ASSERT_EQ(vb.type, SNMP_TAG_COUNTER32);
	ASSERT_EQ(vb.val.uint_val, 12);

	/* icmpOutEchoReps.0 (1.3.6.1.2.1.5.21.0) */
	struct snmp_oid oid_out_echorep = {
		.len = 9,
		.ids = {1, 3, 6, 1, 2, 1, 5, 21, 0},
	};
	memset(&vb, 0, sizeof(vb));
	ret = snmp_mib_get(&s_agent, &oid_out_echorep, &vb);
	ASSERT_EQ(ret, 0);
	ASSERT_EQ(vb.type, SNMP_TAG_COUNTER32);
	ASSERT_EQ(vb.val.uint_val, 8);
}

ZTEST(snmp_mib2, test_mib2_tcp_udp_groups)
{
	int ret;
	struct snmp_varbind vb;

	ret = snmp_agent_init(&s_agent, NULL);
	ASSERT_EQ(ret, 0);

	ret = snmp_mib2_register_tcp(&s_agent);
	ASSERT_EQ(ret, 0);

	ret = snmp_mib2_register_udp(&s_agent);
	ASSERT_EQ(ret, 0);

	/* tcpRtoAlgorithm.0 (1.3.6.1.2.1.6.1.0) */
	struct snmp_oid oid_rto_alg = {
		.len = 9,
		.ids = {1, 3, 6, 1, 2, 1, 6, 1, 0},
	};
	memset(&vb, 0, sizeof(vb));
	ret = snmp_mib_get(&s_agent, &oid_rto_alg, &vb);
	ASSERT_EQ(ret, 0);
	ASSERT_EQ(vb.type, ASN1_TAG_INTEGER);
	ASSERT_EQ(vb.val.int_val, 4);

	/* tcpInSegs.0 (1.3.6.1.2.1.6.10.0) */
	struct snmp_oid oid_tcp_in = {
		.len = 9,
		.ids = {1, 3, 6, 1, 2, 1, 6, 10, 0},
	};
	memset(&vb, 0, sizeof(vb));
	ret = snmp_mib_get(&s_agent, &oid_tcp_in, &vb);
	ASSERT_EQ(ret, 0);
	ASSERT_EQ(vb.type, SNMP_TAG_COUNTER32);
	ASSERT_EQ(vb.val.uint_val, 500);

	/* tcpOutSegs.0 (1.3.6.1.2.1.6.11.0) */
	struct snmp_oid oid_tcp_out = {
		.len = 9,
		.ids = {1, 3, 6, 1, 2, 1, 6, 11, 0},
	};
	memset(&vb, 0, sizeof(vb));
	ret = snmp_mib_get(&s_agent, &oid_tcp_out, &vb);
	ASSERT_EQ(ret, 0);
	ASSERT_EQ(vb.type, SNMP_TAG_COUNTER32);
	ASSERT_EQ(vb.val.uint_val, 450);

	/* udpInDatagrams.0 (1.3.6.1.2.1.7.1.0) */
	struct snmp_oid oid_udp_in = {
		.len = 9,
		.ids = {1, 3, 6, 1, 2, 1, 7, 1, 0},
	};
	memset(&vb, 0, sizeof(vb));
	ret = snmp_mib_get(&s_agent, &oid_udp_in, &vb);
	ASSERT_EQ(ret, 0);
	ASSERT_EQ(vb.type, SNMP_TAG_COUNTER32);
	ASSERT_EQ(vb.val.uint_val, 200);

	/* udpNoPorts.0 (1.3.6.1.2.1.7.2.0) */
	struct snmp_oid oid_udp_noports = {
		.len = 9,
		.ids = {1, 3, 6, 1, 2, 1, 7, 2, 0},
	};
	memset(&vb, 0, sizeof(vb));
	ret = snmp_mib_get(&s_agent, &oid_udp_noports, &vb);
	ASSERT_EQ(ret, 0);
	ASSERT_EQ(vb.type, SNMP_TAG_COUNTER32);
	ASSERT_EQ(vb.val.uint_val, 3);

	/* udpInErrors.0 (1.3.6.1.2.1.7.3.0) */
	struct snmp_oid oid_udp_err = {
		.len = 9,
		.ids = {1, 3, 6, 1, 2, 1, 7, 3, 0},
	};
	memset(&vb, 0, sizeof(vb));
	ret = snmp_mib_get(&s_agent, &oid_udp_err, &vb);
	ASSERT_EQ(ret, 0);
	ASSERT_EQ(vb.type, SNMP_TAG_COUNTER32);
	ASSERT_EQ(vb.val.uint_val, 1);

	/* udpOutDatagrams.0 (1.3.6.1.2.1.7.4.0) */
	struct snmp_oid oid_udp_out = {
		.len = 9,
		.ids = {1, 3, 6, 1, 2, 1, 7, 4, 0},
	};
	memset(&vb, 0, sizeof(vb));
	ret = snmp_mib_get(&s_agent, &oid_udp_out, &vb);
	ASSERT_EQ(ret, 0);
	ASSERT_EQ(vb.type, SNMP_TAG_COUNTER32);
	ASSERT_EQ(vb.val.uint_val, 150);
}
```

## src/test_multi_instance.c
```c
/*
 * Copyright (c) 2026 StructCore Embedded
 * SPDX-License-Identifier: Apache-2.0
 *
 * Multi-Instance Coexistence & Zero-Singleton Unit Tests
 */

#include <stdio.h>
#include <stdlib.h>
#include <string.h>
#include <stddef.h>
#include <errno.h>
#include <zephyr/ztest.h>
#include <zephyr/sys/util.h>
#include <snmp/snmp.h>
#include <snmp/snmp_ber.h>
#include <snmp/snmp_mib.h>
#include <snmp/snmp_core.h>
#include <snmp/snmp_mib2.h>

#define ASSERT(c)          zassert_true(c, #c)
#define ASSERT_EQ(a, b)    zassert_equal(a, b, NULL)
#define ASSERT_NE(a, b)    zassert_not_equal(a, b, NULL)
#define ASSERT_GT(a, b)    zassert_true((a) > (b), NULL)
#define ASSERT_LT(a, b)    zassert_true((a) < (b), NULL)
#define ASSERT_STREQ(a, b) zassert_mem_equal(a, b, strlen(b), NULL)

static int get_val_1111(struct snmp_agent *agent, const struct snmp_mib_node *node,
			struct snmp_varbind *vb)
{
	(void)agent;
	(void)node;
	vb->type = ASN1_TAG_INTEGER;
	vb->val.int_val = 1234;
	return 0;
}

static int get_val_2222(struct snmp_agent *agent, const struct snmp_mib_node *node,
			struct snmp_varbind *vb)
{
	(void)agent;
	(void)node;
	vb->type = ASN1_TAG_INTEGER;
	vb->val.int_val = 5678;
	return 0;
}

static size_t build_get_req_packet(uint8_t *buf, size_t buf_sz, const char *community,
				   const struct snmp_oid *oid, int32_t req_id)
{
	struct snmp_pdu pdu;
	memset(&pdu, 0, sizeof(pdu));

	pdu.version = 1; /* SNMPv2c */
	pdu.type = SNMP_PDU_GET_REQ;
	pdu.request_id = req_id;
	strncpy((char *)pdu.community, community, sizeof(pdu.community) - 1);
	pdu.community_len = strlen((char *)pdu.community);

	pdu.varbind_cnt = 1;
	pdu.varbinds[0].oid = *oid;
	pdu.varbinds[0].type = ASN1_TAG_NULL;

	size_t enc_len = 0;
	int ret = snmp_ber_encode_pdu(buf, buf_sz, &enc_len, &pdu);
	ASSERT_EQ(ret, 0);

	return enc_len;
}

ZTEST(snmp_multi_instance, test_multi_instance_coexistence)
{
	static struct snmp_agent lan_agent;
	static struct snmp_agent wan_agent;

	/* 1. Initialize both independent instances */
	int ret = snmp_agent_init(&lan_agent, NULL);
	ASSERT_EQ(ret, 0);

	ret = snmp_agent_init(&wan_agent, NULL);
	ASSERT_EQ(ret, 0);

	/* 2. Configure distinct community strings */
	ret = snmp_agent_set_read_community(&lan_agent, "lan_pub");
	ASSERT_EQ(ret, 0);
	ret = snmp_agent_set_read_community(&wan_agent, "wan_pub");
	ASSERT_EQ(ret, 0);

	/* 3. Configure distinct sysName strings */
	ret = snmp_mib2_set_sysname(&lan_agent, "router-lan");
	ASSERT_EQ(ret, 0);
	ret = snmp_mib2_set_sysname(&wan_agent, "gateway-wan");
	ASSERT_EQ(ret, 0);

	/* 4. Register scalar .1.3.6.1.4.1.1111.1.0 on lan_agent only */
	struct snmp_mib_node node1 = {0};
	node1.oid.len = 9;

	node1.oid.ids[0] = 1;
	node1.oid.ids[1] = 3;
	node1.oid.ids[2] = 6;
	node1.oid.ids[3] = 1;
	node1.oid.ids[4] = 4;
	node1.oid.ids[5] = 1;
	node1.oid.ids[6] = 1111;
	node1.oid.ids[7] = 1;
	node1.oid.ids[8] = 0;
	node1.type = ASN1_TAG_INTEGER;
	node1.get_cb = get_val_1111;
	ret = snmp_mib_register(&lan_agent, &node1);
	ASSERT_EQ(ret, 0);

	/* 5. Register scalar .1.3.6.1.4.1.2222.1.0 on wan_agent only */
	struct snmp_mib_node node2 = {0};
	node2.oid.len = 9;

	node2.oid.ids[0] = 1;
	node2.oid.ids[1] = 3;
	node2.oid.ids[2] = 6;
	node2.oid.ids[3] = 1;
	node2.oid.ids[4] = 4;
	node2.oid.ids[5] = 1;
	node2.oid.ids[6] = 2222;
	node2.oid.ids[7] = 1;
	node2.oid.ids[8] = 0;
	node2.type = ASN1_TAG_INTEGER;
	node2.get_cb = get_val_2222;
	ret = snmp_mib_register(&wan_agent, &node2);
	ASSERT_EQ(ret, 0);

	uint8_t req_buf[512];
	uint8_t resp_buf[512];
	size_t req_len;
	size_t resp_len;
	struct snmp_pdu resp_pdu;

	/* 6. Query lan_agent for .1.3.6.1.4.1.1111.1.0 with community "lan_pub" */
	req_len = build_get_req_packet(req_buf, sizeof(req_buf), "lan_pub", &node1.oid, 101);
	ret = snmp_agent_process_pdu(&lan_agent, req_buf, req_len, resp_buf, sizeof(resp_buf),
				     &resp_len);
	ASSERT_EQ(ret, 0);
	ASSERT(resp_len > 0);

	memset(&resp_pdu, 0, sizeof(resp_pdu));
	ret = snmp_ber_decode_pdu(resp_buf, resp_len, &resp_pdu);
	ASSERT_EQ(ret, 0);
	ASSERT_EQ(resp_pdu.error_status, 0);
	ASSERT_EQ(resp_pdu.varbind_cnt, 1);
	ASSERT_EQ(resp_pdu.varbinds[0].type, ASN1_TAG_INTEGER);
	ASSERT_EQ(resp_pdu.varbinds[0].val.int_val, 1234);

	/* Assert LAN agent statistics incremented, WAN agent untouched */
	ASSERT_EQ(lan_agent.counters.snmpInPkts, 1);
	ASSERT_EQ(lan_agent.counters.snmpOutPkts, 1);
	ASSERT_EQ(wan_agent.counters.snmpInPkts, 0);
	ASSERT_EQ(wan_agent.counters.snmpOutPkts, 0);

	/* 7. Send "lan_pub" request to wan_agent -> must be rejected (-EACCES) */
	ret = snmp_agent_process_pdu(&wan_agent, req_buf, req_len, resp_buf, sizeof(resp_buf),
				     &resp_len);
	ASSERT_EQ(ret, -EACCES);
	ASSERT_EQ(wan_agent.counters.snmpInPkts, 1);
	ASSERT_EQ(wan_agent.counters.snmpInBadCommunityNames, 1);
	ASSERT_EQ(wan_agent.counters.snmpOutPkts, 0);
	ASSERT_EQ(lan_agent.counters.snmpInBadCommunityNames, 0);

	/* 8. Query wan_agent for .1.3.6.1.4.1.2222.1.0 with community "wan_pub" */
	req_len = build_get_req_packet(req_buf, sizeof(req_buf), "wan_pub", &node2.oid, 202);
	ret = snmp_agent_process_pdu(&wan_agent, req_buf, req_len, resp_buf, sizeof(resp_buf),
				     &resp_len);
	ASSERT_EQ(ret, 0);
	ASSERT(resp_len > 0);

	memset(&resp_pdu, 0, sizeof(resp_pdu));
	ret = snmp_ber_decode_pdu(resp_buf, resp_len, &resp_pdu);
	ASSERT_EQ(ret, 0);
	ASSERT_EQ(resp_pdu.error_status, 0);
	ASSERT_EQ(resp_pdu.varbind_cnt, 1);
	ASSERT_EQ(resp_pdu.varbinds[0].type, ASN1_TAG_INTEGER);
	ASSERT_EQ(resp_pdu.varbinds[0].val.int_val, 5678);
	ASSERT_EQ(wan_agent.counters.snmpInPkts, 2);
	ASSERT_EQ(wan_agent.counters.snmpOutPkts, 1);

	/* 9. Cross-instance isolation: Query lan_agent for .1.3.6.1.4.1.2222.1.0 (WAN OID) */
	req_len = build_get_req_packet(req_buf, sizeof(req_buf), "lan_pub", &node2.oid, 103);
	ret = snmp_agent_process_pdu(&lan_agent, req_buf, req_len, resp_buf, sizeof(resp_buf),
				     &resp_len);
	ASSERT_EQ(ret, 0);
	memset(&resp_pdu, 0, sizeof(resp_pdu));
	ret = snmp_ber_decode_pdu(resp_buf, resp_len, &resp_pdu);
	ASSERT_EQ(ret, 0);
	/* In SNMPv2c, an unmapped OID produces SNMP_TAG_EXCEPT_NO_SUCH_OBJ or noSuchName error */
	ASSERT(resp_pdu.varbinds[0].type == SNMP_TAG_EXCEPT_NO_SUCH_OBJ ||
	       resp_pdu.varbinds[0].type == SNMP_TAG_EXCEPT_NO_SUCH_INST ||
	       resp_pdu.error_status == SNMP_ERR_NO_SUCH_NAME);

	/* 10. Cross-instance isolation: Query wan_agent for .1.3.6.1.4.1.1111.1.0 (LAN OID) */
	req_len = build_get_req_packet(req_buf, sizeof(req_buf), "wan_pub", &node1.oid, 204);
	ret = snmp_agent_process_pdu(&wan_agent, req_buf, req_len, resp_buf, sizeof(resp_buf),
				     &resp_len);
	ASSERT_EQ(ret, 0);
	memset(&resp_pdu, 0, sizeof(resp_pdu));
	ret = snmp_ber_decode_pdu(resp_buf, resp_len, &resp_pdu);
	ASSERT_EQ(ret, 0);
	ASSERT(resp_pdu.varbinds[0].type == SNMP_TAG_EXCEPT_NO_SUCH_OBJ ||
	       resp_pdu.varbinds[0].type == SNMP_TAG_EXCEPT_NO_SUCH_INST ||
	       resp_pdu.error_status == SNMP_ERR_NO_SUCH_NAME);

	/* 11. Query MIB-II sysName on lan_agent -> should return "router-lan" */
	struct snmp_oid sysname_oid = {.len = 9, .ids = {1, 3, 6, 1, 2, 1, 1, 5, 0}};
	req_len = build_get_req_packet(req_buf, sizeof(req_buf), "lan_pub", &sysname_oid, 105);

	ret = snmp_agent_process_pdu(&lan_agent, req_buf, req_len, resp_buf, sizeof(resp_buf),
				     &resp_len);
	ASSERT_EQ(ret, 0);
	memset(&resp_pdu, 0, sizeof(resp_pdu));
	ret = snmp_ber_decode_pdu(resp_buf, resp_len, &resp_pdu);
	ASSERT_EQ(ret, 0);
	ASSERT_EQ(resp_pdu.error_status, 0);
	ASSERT_EQ(resp_pdu.varbinds[0].type, ASN1_TAG_OCTET_STRING);
	ASSERT_EQ(strcmp((char *)resp_pdu.varbinds[0].val.octet_str.data, "router-lan"), 0);

	/* 12. Query MIB-II sysName on wan_agent -> should return "gateway-wan" */
	req_len = build_get_req_packet(req_buf, sizeof(req_buf), "wan_pub", &sysname_oid, 206);
	ret = snmp_agent_process_pdu(&wan_agent, req_buf, req_len, resp_buf, sizeof(resp_buf),
				     &resp_len);
	ASSERT_EQ(ret, 0);
	memset(&resp_pdu, 0, sizeof(resp_pdu));
	ret = snmp_ber_decode_pdu(resp_buf, resp_len, &resp_pdu);
	ASSERT_EQ(ret, 0);
	ASSERT_EQ(resp_pdu.error_status, 0);
	ASSERT_EQ(resp_pdu.varbinds[0].type, ASN1_TAG_OCTET_STRING);
	ASSERT_EQ(strcmp((char *)resp_pdu.varbinds[0].val.octet_str.data, "gateway-wan"), 0);
}

/* -------------------------------------------------------------------------- */
/* MIB-II snmp-group (1.3.6.1.2.1.11) counter isolation                        */
/*                                                                            */
/* Every double-count / global mirror listed in design contract 6.2 leaks the  */
/* traffic of one agent into another agent's statistics. Driving traffic       */
/* exclusively on agent A and then reading the whole .11 group out of both    */
/* agents' trees catches all of them at once, host-side, without sockets.     */
/* -------------------------------------------------------------------------- */

/* RFC 3418 / RFC 1213: sub-identifiers 7 and 23 of the snmp group do not exist. */
static const uint32_t ci_subids[] = {
	1,  2,  3,  4,  5,  6,  8,  9,  10, 11, 12, 13, 14, 15, 16,
	17, 18, 19, 20, 21, 22, 24, 25, 26, 27, 28, 29, 30, 31, 32,
};

static void ci_make_counter_oid(struct snmp_oid *oid, uint32_t subid)
{
	oid->len = 9;
	oid->ids[0] = 1;
	oid->ids[1] = 3;
	oid->ids[2] = 6;
	oid->ids[3] = 1;
	oid->ids[4] = 2;
	oid->ids[5] = 1;
	oid->ids[6] = 11;
	oid->ids[7] = subid;
	oid->ids[8] = 0;
}

static size_t ci_build_request(uint8_t *buf, size_t buf_sz, const char *community,
			       const struct snmp_oid *oid, uint8_t pdu_type, int32_t req_id,
			       int32_t max_rep)
{
	struct snmp_pdu pdu;
	memset(&pdu, 0, sizeof(pdu));

	pdu.version = 1; /* SNMPv2c */
	pdu.type = pdu_type;
	pdu.request_id = req_id;
	pdu.max_repetitions = max_rep;
	strncpy((char *)pdu.community, community, sizeof(pdu.community) - 1);
	pdu.community_len = strlen((char *)pdu.community);
	pdu.varbind_cnt = 1;
	pdu.varbinds[0].oid = *oid;
	pdu.varbinds[0].type = ASN1_TAG_NULL;

	size_t enc_len = 0;
	ASSERT_EQ(snmp_ber_encode_pdu(buf, buf_sz, &enc_len, &pdu), 0);

	return enc_len;
}

/* Read one .11.<subid>.0 node of this agent through its own MIB tree. */
static uint32_t ci_read_counter(struct snmp_agent *agent, uint32_t subid)
{
	struct snmp_oid oid;
	ci_make_counter_oid(&oid, subid);

	struct snmp_varbind vb;
	memset(&vb, 0, sizeof(vb));

	int ret = snmp_mib_get(agent, &oid, &vb);
	zassert_equal(ret, 0, "snmp_mib_get(.11.%u.0) -> %d", subid, ret);

	return vb.val.uint_val;
}

ZTEST(snmp_multi_instance, test_multi_instance_counter_isolation)
{
	static struct snmp_agent agent_a;
	static struct snmp_agent agent_b;

	ASSERT_EQ(snmp_agent_init(&agent_a, NULL), 0);
	ASSERT_EQ(snmp_agent_init(&agent_b, NULL), 0);
	ASSERT_EQ(snmp_agent_set_read_community(&agent_a, "pubA"), 0);
	ASSERT_EQ(snmp_agent_set_read_community(&agent_b, "pubB"), 0);

	uint8_t req[512];
	uint8_t resp[512];
	size_t len;
	size_t resp_len;

	struct snmp_oid sysname = {
		.len = 9,
		.ids = {1, 3, 6, 1, 2, 1, 1, 5, 0},
	};
	struct snmp_oid absent = {
		.len = 9,
		.ids = {1, 3, 6, 1, 4, 1, 99999, 1, 0},
	};
	struct snmp_oid uptime = {
		.len = 9,
		.ids = {1, 3, 6, 1, 2, 1, 1, 3, 0},
	};

	/* --- Traffic on agent A only, exercising as many counter paths as possible --- */

	/* 1. Successful GET */
	len = ci_build_request(req, sizeof(req), "pubA", &sysname, SNMP_PDU_GET_REQ, 1, 0);
	snmp_agent_process_pdu(&agent_a, req, len, resp, sizeof(resp), &resp_len);

	/* 2. Successful GETNEXT */
	len = ci_build_request(req, sizeof(req), "pubA", &sysname, SNMP_PDU_GET_NEXT_REQ, 2, 0);
	snmp_agent_process_pdu(&agent_a, req, len, resp, sizeof(resp), &resp_len);

	/* 3. GETBULK: the snmpInTotalReqVars accumulation path of contract 6.2 */
	len = ci_build_request(req, sizeof(req), "pubA", &sysname, SNMP_PDU_GET_BULK_REQ, 3, 3);
	snmp_agent_process_pdu(&agent_a, req, len, resp, sizeof(resp), &resp_len);

	/* 4. Wrong community (snmpInBadCommunityNames path) */
	len = ci_build_request(req, sizeof(req), "wrong", &sysname, SNMP_PDU_GET_REQ, 4, 0);
	ASSERT_EQ(snmp_agent_process_pdu(&agent_a, req, len, resp, sizeof(resp), &resp_len),
		  -EACCES);

	/* 5. Unknown OID (snmpInNoSuchNames / snmpOutNoSuchNames path) */
	len = ci_build_request(req, sizeof(req), "pubA", &absent, SNMP_PDU_GET_REQ, 5, 0);
	snmp_agent_process_pdu(&agent_a, req, len, resp, sizeof(resp), &resp_len);

	/* 6. SET on a read-only object (snmpInReadOnlys path) */
	len = ci_build_request(req, sizeof(req), "pubA", &uptime, SNMP_PDU_SET_REQ, 6, 0);
	snmp_agent_process_pdu(&agent_a, req, len, resp, sizeof(resp), &resp_len);

	/* --- The assertion that catches every mirror bug of contract 6.2 --- */

	/* 7. A saw all of that traffic; every counter of B must still read zero. */
	ASSERT(ci_read_counter(&agent_a, 1) > 0); /* snmpInPkts */
	for (size_t i = 0; i < ARRAY_SIZE(ci_subids); i++) {
		uint32_t sub = ci_subids[i];
		uint32_t val_b = ci_read_counter(&agent_b, sub);
		if (sub == 30) { /* snmpEnableAuthenTraps defaults to 1, not a counter */

			ASSERT_EQ(val_b, 1);
		} else {
			zassert_equal(val_b, 0, "agent B .11.%u.0 reads %u, expected 0", sub,
				      val_b);
		}
	}

	/* 8. Cross-check the MIB nodes against the snapshot API of the same fields. */
	struct snmp_mib2_counters cb;
	snmp_agent_get_counters(&agent_b, &cb);

	const uint32_t *words = (const uint32_t *)&cb;
	size_t authen_word =
		offsetof(struct snmp_mib2_counters, snmpEnableAuthenTraps) / sizeof(uint32_t);
	for (size_t i = 0; i < sizeof(cb) / sizeof(uint32_t); i++) {
		if (i == authen_word) {
			continue;
		}
		zassert_equal(words[i], 0, "agent B counter word %zu reads %u", i, words[i]);
	}

	/* 9. A's own counters did move, and they are visible through the MIB too. */
	struct snmp_mib2_counters ca;
	snmp_agent_get_counters(&agent_a, &ca);

	ASSERT(ca.snmpInPkts > 0);
	ASSERT(ca.snmpInBadCommunityNames > 0);
	ASSERT(ca.snmpInTotalReqVars > 0);
	ASSERT_EQ(ci_read_counter(&agent_a, 1), ca.snmpInPkts);
	ASSERT_EQ(ci_read_counter(&agent_a, 13), ca.snmpInTotalReqVars);

	/* 10. The one writable snmp-group object is per-agent as well: setting .11.30.0
	 *     on A (RFC 3418 INTEGER 1|2) must not change B.
	 */
	struct snmp_varbind vb_set;
	memset(&vb_set, 0, sizeof(vb_set));

	vb_set.type = ASN1_TAG_INTEGER;
	vb_set.val.int_val = 2;
	struct snmp_oid authen = {
		.len = 9,
		.ids = {1, 3, 6, 1, 2, 1, 11, 30, 0},
	};
	ASSERT_EQ(snmp_mib_set(&agent_a, &authen, &vb_set), 0);
	ASSERT_EQ(agent_a.counters.snmpEnableAuthenTraps, 2);
	ASSERT_EQ(agent_b.counters.snmpEnableAuthenTraps, 1);
	ASSERT_EQ(ci_read_counter(&agent_b, 30), 1);

	/* 11. MIB-II default nodes must not alias instance state via user_data
	 *     (decision 2): every system-group and snmp-group node carries NULL.
	 */
	for (size_t i = 0; i < agent_a.mib_node_cnt; i++) {
		const struct snmp_mib_node *n = &agent_a.mib_nodes[i];
		if (n->oid.len == 9 && n->oid.ids[0] == 1 && n->oid.ids[3] == 1 &&

		    n->oid.ids[5] == 1 && (n->oid.ids[6] == 1 || n->oid.ids[6] == 11)) {
			zassert_is_null(
				n->user_data,
				"default node still aliases instance state through user_data");
		}
	}

	/* 12. Counter clearing is per-agent too. */
	snmp_agent_zero_counters(&agent_a);
	snmp_agent_get_counters(&agent_a, &ca);
	snmp_agent_get_counters(&agent_b, &cb);
	ASSERT_EQ(ca.snmpInPkts, 0);
	ASSERT_EQ(ca.snmpEnableAuthenTraps, 1);
	/* B was never touched: not by A's SET of .11.30.0, not by A's clearing. */
	ASSERT_EQ(cb.snmpInPkts, 0);
	ASSERT_EQ(cb.snmpEnableAuthenTraps, 1);
}

ZTEST(snmp_multi_instance, test_agent_lifecycle)
{
	static struct snmp_agent agent;
	struct snmp_agent_cfg cfg = {
		.port = 1161,
		.sys_name = "LifecycleTest",
	};

	/* 1. NULL checks and uninitialized operations return -EINVAL or -EPERM */
	ASSERT_EQ(snmp_agent_init(NULL, &cfg), -EINVAL);

	/* 2. Initialize agent */
	ASSERT_EQ(snmp_agent_init(&agent, &cfg), 0);
	ASSERT_EQ(agent.state, SNMP_AGENT_INITIALIZED);

#if defined(__ZEPHYR__)
	/* 3. Start agent */
	ASSERT_EQ(snmp_agent_start(&agent), 0);
	ASSERT_EQ(agent.state, SNMP_AGENT_RUNNING);

	/* 4. Double-start is rejected with -EPERM */
	ASSERT_EQ(snmp_agent_start(&agent), -EPERM);

	/* 5. Re-init while running is rejected with -EBUSY */
	ASSERT_EQ(snmp_agent_init(&agent, &cfg), -EBUSY);

	/* 6. Stop agent */
	ASSERT_EQ(snmp_agent_stop(&agent), 0);
	ASSERT_EQ(agent.state, SNMP_AGENT_STOPPED);

	/* 7. Stop is idempotent */
	ASSERT_EQ(snmp_agent_stop(&agent), 0);

	/* 8. Restart after stop */
	ASSERT_EQ(snmp_agent_start(&agent), 0);
	ASSERT_EQ(agent.state, SNMP_AGENT_RUNNING);
	ASSERT_EQ(snmp_agent_stop(&agent), 0);
#endif

	/* 9. Deinit agent resets to INITIALIZED */
	ASSERT_EQ(snmp_agent_deinit(&agent), 0);
	ASSERT_EQ(agent.state, SNMP_AGENT_INITIALIZED);
}
```

## src/test_oid.c
```c
/*
 * Copyright (c) 2026 StructCore Embedded
 * SPDX-License-Identifier: Apache-2.0
 *
 * OID Handling Unit Tests
 */

#include <stdio.h>
#include <stdlib.h>
#include <string.h>
#include <zephyr/ztest.h>
#include <snmp/snmp_ber.h>

#define ASSERT(c)          zassert_true(c, #c)
#define ASSERT_EQ(a, b)    zassert_equal(a, b, NULL)
#define ASSERT_NE(a, b)    zassert_not_equal(a, b, NULL)
#define ASSERT_GT(a, b)    zassert_true((a) > (b), NULL)
#define ASSERT_LT(a, b)    zassert_true((a) < (b), NULL)
#define ASSERT_STREQ(a, b) zassert_mem_equal(a, b, strlen(b), NULL)

ZTEST(snmp_oid, test_oid_equal)
{
	struct snmp_oid a = {.len = 5, .ids = {1, 3, 6, 1, 2}};
	struct snmp_oid b = {.len = 5, .ids = {1, 3, 6, 1, 2}};
	struct snmp_oid c = {.len = 5, .ids = {1, 3, 6, 1, 3}};
	struct snmp_oid d = {.len = 4, .ids = {1, 3, 6, 1}};

	ASSERT(snmp_oid_equal(&a, &b) == true);
	ASSERT(snmp_oid_equal(&a, &c) == false);
	ASSERT(snmp_oid_equal(&a, &d) == false);
	ASSERT(snmp_oid_equal(NULL, &a) == false);
	ASSERT(snmp_oid_equal(&a, NULL) == false);
}

ZTEST(snmp_oid, test_oid_compare_lexicographic)
{
	struct snmp_oid a = {.len = 5, .ids = {1, 3, 6, 1, 2}};
	struct snmp_oid b = {.len = 5, .ids = {1, 3, 6, 1, 3}};
	struct snmp_oid c = {.len = 6, .ids = {1, 3, 6, 1, 2, 1}};
	struct snmp_oid d = {.len = 4, .ids = {1, 3, 6, 1}};

	ASSERT(snmp_oid_compare(&a, &b) < 0);
	ASSERT(snmp_oid_compare(&b, &a) > 0);
	ASSERT(snmp_oid_compare(&a, &a) == 0);
	ASSERT(snmp_oid_compare(&d, &a) < 0);
	ASSERT(snmp_oid_compare(&c, &a) > 0);
}

ZTEST(snmp_oid, test_oid_encode_decode_roundtrip)
{
	uint8_t buf[256];
	size_t off = 0;

	struct snmp_oid original = {.len = 14,
				    .ids = {1, 3, 6, 1, 4, 1, 54321, 1, 2, 3, 4, 5, 6, 0}};

	int ret = snmp_ber_encode_oid(buf, 256, &off, &original);
	ASSERT_EQ(ret, 0);

	size_t dec_off = 0;
	struct snmp_oid decoded = {0};
	ret = snmp_ber_decode_oid(buf, off, &dec_off, &decoded);

	ASSERT_EQ(ret, 0);
	ASSERT_EQ(decoded.len, original.len);
	for (int i = 0; i < original.len; i++) {
		ASSERT_EQ(decoded.ids[i], original.ids[i]);
	}
}

ZTEST(snmp_oid, test_oid_max_depth)
{
	uint8_t buf[256];
	size_t off = 0;

	struct snmp_oid max_oid = {.len = 16,
				   .ids = {1, 3, 6, 1, 2, 1, 1, 1, 1, 1, 1, 1, 1, 1, 1, 1}};

	int ret = snmp_ber_encode_oid(buf, 256, &off, &max_oid);
	ASSERT_EQ(ret, 0);

	size_t dec_off = 0;
	struct snmp_oid decoded = {0};
	ret = snmp_ber_decode_oid(buf, off, &dec_off, &decoded);

	ASSERT_EQ(ret, 0);
	ASSERT_EQ(decoded.len, 16);
}
```

## src/test_trap.c
```c
/*
 * Copyright (c) 2026 StructCore Embedded
 * SPDX-License-Identifier: Apache-2.0
 *
 * Trap Destination & Custom Port Unit Tests
 */

#include <stdio.h>
#include <stdlib.h>
#include <string.h>
#include <errno.h>
#include <zephyr/ztest.h>
#include <zephyr/net/socket.h>
#include <snmp/snmp.h>
#include <snmp/snmp_core.h>
#include <snmp/snmp_trap.h>

#define ASSERT(c)       zassert_true(c, #c)
#define ASSERT_EQ(a, b) zassert_equal(a, b, NULL)
#define ASSERT_NE(a, b) zassert_not_equal(a, b, NULL)

static struct snmp_agent s_agent;

ZTEST(snmp_trap, test_trap_default_port)
{
	int ret = snmp_agent_init(&s_agent, NULL);
	ASSERT_EQ(ret, 0);

	ret = snmp_trap_add_destination(&s_agent, "192.168.1.100");
	ASSERT_EQ(ret, 0);
	ASSERT_EQ(s_agent.trap_dest_cnt, 1);
	ASSERT_EQ(net_ntohs(s_agent.trap_dests[0].sin_port), CONFIG_SNMP_TRAP_PORT);

	struct net_in_addr exp;
	ret = zsock_inet_pton(NET_AF_INET, "192.168.1.100", &exp);
	ASSERT_EQ(ret, 1);
	ASSERT_EQ(s_agent.trap_dests[0].sin_addr.s_addr, exp.s_addr);
}

ZTEST(snmp_trap, test_trap_custom_port_arg)
{
	int ret = snmp_agent_init(&s_agent, NULL);
	ASSERT_EQ(ret, 0);

	ret = snmp_trap_add_destination_port(&s_agent, "192.168.1.101", 1162);
	ASSERT_EQ(ret, 0);
	ASSERT_EQ(s_agent.trap_dest_cnt, 1);
	ASSERT_EQ(net_ntohs(s_agent.trap_dests[0].sin_port), 1162);

	struct net_in_addr exp;
	ret = zsock_inet_pton(NET_AF_INET, "192.168.1.101", &exp);
	ASSERT_EQ(ret, 1);
	ASSERT_EQ(s_agent.trap_dests[0].sin_addr.s_addr, exp.s_addr);
}

ZTEST(snmp_trap, test_trap_inline_port_syntax)
{
	int ret = snmp_agent_init(&s_agent, NULL);
	ASSERT_EQ(ret, 0);

	ret = snmp_trap_add_destination(&s_agent, "192.168.1.102:2162");
	ASSERT_EQ(ret, 0);
	ASSERT_EQ(s_agent.trap_dest_cnt, 1);
	ASSERT_EQ(net_ntohs(s_agent.trap_dests[0].sin_port), 2162);

	ret = snmp_trap_add_destination(&s_agent, "[192.168.1.103]:3162");
	ASSERT_EQ(ret, 0);
	ASSERT_EQ(s_agent.trap_dest_cnt, 2);
	ASSERT_EQ(net_ntohs(s_agent.trap_dests[1].sin_port), 3162);

	struct net_in_addr exp1;
	struct net_in_addr exp2;
	zsock_inet_pton(NET_AF_INET, "192.168.1.102", &exp1);
	zsock_inet_pton(NET_AF_INET, "192.168.1.103", &exp2);
	ASSERT_EQ(s_agent.trap_dests[0].sin_addr.s_addr, exp1.s_addr);
	ASSERT_EQ(s_agent.trap_dests[1].sin_addr.s_addr, exp2.s_addr);
}

ZTEST(snmp_trap, test_trap_four_independent_servers)
{
	int ret = snmp_agent_init(&s_agent, NULL);
	ASSERT_EQ(ret, 0);

	/* Server 1: default port 162 */
	ret = snmp_trap_add_destination(&s_agent, "10.0.0.1");
	ASSERT_EQ(ret, 0);

	/* Server 2: custom port 1162 via parameter */
	ret = snmp_trap_add_destination_port(&s_agent, "10.0.0.2", 1162);
	ASSERT_EQ(ret, 0);

	/* Server 3: custom port 2162 via inline syntax */
	ret = snmp_trap_add_destination(&s_agent, "10.0.0.3:2162");
	ASSERT_EQ(ret, 0);

	/* Server 4: custom port 3162 via bracket syntax */
	ret = snmp_trap_add_destination_port(&s_agent, "[10.0.0.4]:3162", 3162);
	ASSERT_EQ(ret, 0);

	ASSERT_EQ(s_agent.trap_dest_cnt, 4);
	ASSERT_EQ(net_ntohs(s_agent.trap_dests[0].sin_port), 162);
	ASSERT_EQ(net_ntohs(s_agent.trap_dests[1].sin_port), 1162);
	ASSERT_EQ(net_ntohs(s_agent.trap_dests[2].sin_port), 2162);
	ASSERT_EQ(net_ntohs(s_agent.trap_dests[3].sin_port), 3162);

	/* 5th server exceeds CONFIG_SNMP_TRAP_DEST_COUNT (4) */
	ret = snmp_trap_add_destination(&s_agent, "10.0.0.5");
	ASSERT_EQ(ret, -ENOMEM);
	ASSERT_EQ(s_agent.trap_dest_cnt, 4);
}

ZTEST(snmp_trap, test_trap_clear_destinations)
{
	int ret = snmp_agent_init(&s_agent, NULL);
	ASSERT_EQ(ret, 0);

	ret = snmp_trap_add_destination(&s_agent, "10.0.0.1");
	ASSERT_EQ(ret, 0);
	ret = snmp_trap_add_destination(&s_agent, "10.0.0.2");
	ASSERT_EQ(ret, 0);
	ASSERT_EQ(s_agent.trap_dest_cnt, 2);

	ret = snmp_trap_clear_destinations(&s_agent);
	ASSERT_EQ(ret, 0);
	ASSERT_EQ(s_agent.trap_dest_cnt, 0);

	/* Can add 4 destinations again */
	ASSERT_EQ(snmp_trap_add_destination(&s_agent, "10.0.0.1"), 0);
	ASSERT_EQ(snmp_trap_add_destination(&s_agent, "10.0.0.2"), 0);
	ASSERT_EQ(snmp_trap_add_destination(&s_agent, "10.0.0.3"), 0);
	ASSERT_EQ(snmp_trap_add_destination(&s_agent, "10.0.0.4"), 0);
	ASSERT_EQ(s_agent.trap_dest_cnt, 4);
}

ZTEST(snmp_trap, test_trap_validation_errors)
{
	int ret = snmp_agent_init(&s_agent, NULL);
	ASSERT_EQ(ret, 0);

	ASSERT_EQ(snmp_trap_add_destination(NULL, "10.0.0.1"), -EINVAL);
	ASSERT_EQ(snmp_trap_add_destination(&s_agent, NULL), -EINVAL);
	ASSERT_EQ(snmp_trap_clear_destinations(NULL), -EINVAL);

	/* Bad IP */
	ASSERT_EQ(snmp_trap_add_destination(&s_agent, "not.an.ip"), -EINVAL);
	ASSERT_EQ(snmp_trap_add_destination(&s_agent, "256.1.1.1"), -EINVAL);

	/* Bad ports */
	ASSERT_EQ(snmp_trap_add_destination(&s_agent, "10.0.0.1:0"), -EINVAL);
	ASSERT_EQ(snmp_trap_add_destination(&s_agent, "10.0.0.1:70000"), -EINVAL);
	ASSERT_EQ(snmp_trap_add_destination(&s_agent, "10.0.0.1:abc"), -EINVAL);

	/* Conflict */
	ASSERT_EQ(snmp_trap_add_destination_port(&s_agent, "10.0.0.1:1162", 2162), -EINVAL);

	/* Bad brackets */
	ASSERT_EQ(snmp_trap_add_destination(&s_agent, "[10.0.0.1"), -EINVAL);
	ASSERT_EQ(snmp_trap_add_destination(&s_agent, "[10.0.0.1]extra"), -EINVAL);
}
```
